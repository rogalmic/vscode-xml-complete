AUTOSAR XML (schema 4.0)
package /AUTOSAR/Documents/SWS_ExecutionManagement/Documentations
  documentation SWS_ExecutionManagement  # Specification of Execution Management
    documentation-content table=tgroup=tbody=[entry=p=l-1=Document Change History, [p=l-1=Date, p=l-1=Release, p=l-1=Changed by, p=l-1=Description], [p=l-1=2019-03-29, p=l-1=19-03, p=l-1=AUTOSAR Release Management, list=[p=l-1=Refinement of State Management semantics, p=l-1=Document structure modified to reflect current template]], [p=l-1=2018-10-31, p=l-1=18-10, p=l-1=AUTOSAR Release Management, list=[p=l-1=Refinement of Deterministic Execution, p=l-1=Updated Process lifecycle to clarify Process and Execution States, p=l-1=Updated Application Recovery Actions]], [p=l-1=2018-03-29, p=l-1=18-03, p=l-1=AUTOSAR Release Management, list=[p=l-1=Deterministic Execution, p=l-1=Resource Limitation, p=l-1=State Management, p=l-1=Fault Tolerance elaboration]], [p=l-1=2017-10-27, p=l-1=17-10, p=l-1=AUTOSAR Release Management, list=[p=l-1=State Management elaboration, introduction of Function Groups, p=l-1=Recovery actions for Platform Health Management, p=l-1=Resource limitation and deterministic execution]], [p=l-1=2017-03-31, p=l-1=17-03, p=l-1=AUTOSAR Release Management, list=item=p=l-1=Initial release]], msr-query-topic-1=msr-query-props=msr-query-name=ARDisclaimer:
      topic 1 topic_3a_Reqent_Levels__6989dc73: msr-query-p-2=msr-query-props=msr-query-name=ARRequirementLevels, msr-query-topic-1=msr-query-props=msr-query-name=tableofcontents  # Requirement Levels
      11 x chapter:
        chap_3a_Introduction:  # Introduction and functional overview
          p=l-1=This document is the software specification of the Execution Management functional cluster within the Adaptive Platform Foundation.
          p=l-1=[Execution Management, Application, Execution Management, Operating System, Application]
          p=l-1=Chapter chap_3a_EMFuncSpec describes how Execution Management concepts are realized within the AUTOSAR Adaptive Platform.
          p=l-1=Chapter chap_3a_APISpec documents the Execution Management Application Programming Interface (API). Inter-functional cluster (IFC) interfaces are described in Appendix chap_3a_IfcInterfaces.
          chapter chap_3a_What_is_Exeion_Mannt_3f___210c7f7d: p=l-1=[Execution Management, Adaptive Platform Foundation, Adaptive Application, Manifest, Executable], p=l-1=The Execution Management functional cluster is part of the AUTOSAR Adaptive Platform. However, the AUTOSAR Adaptive Platform is usually not exclusively used within a single AUTOSAR System as the vehicle is also equipped with a number of ECUs developed on the AUTOSAR Classic Platform. The System design for the entire vehicle will therefore cover both AUTOSAR Classic Platform ECUs as well as AUTOSAR Adaptive Platform Machine.  # What is Execution Management?
          chapter chap_3a_Intion_with_AUTSAR_Runime_for_Adaive__9e290194:  # Interaction with AUTOSAR Runtime for Adaptive
            p=l-1=The set of programming interfaces to the Adaptive Application is called AUTOSAR Runtime for Adaptive (ARA). The interfaces that constitute ARA include those of Execution Management specified in Chapter chap_3a_APISpec. Note that interfaces which are exclusively accessed within the AUTOSAR Adaptive Platform are defined as inter-functional cluster (IFC) interfaces (see Appendix chap_3a_IfcInterfaces), which are not part of ARA.
            p=l-1=[Execution Management, Application, Execution Management, Application, Execution Management, AUTOSAR Adaptive Platform]
            p=l-1=The Adaptive AUTOSAR Services are provided via mechanisms provided by the Communication Management functional cluster SWS_2d_CommunicationManagement of the Adaptive Platform Foundation. In order to use the Adaptive AUTOSAR Services, the functional clusters in the Adaptive Platform Foundation must be properly initialized beforehand. Please refer to the respective specifications regarding more information on Communication Management.
        chap_3a_Acronyms:  # Acronyms and abbreviations
          p=l-1=All technical terms used throughout this document -- except the ones listed here -- can be found in the official TR_2d_Glossary AUTOSAR Glossary or TPS_2d_ManifestSpecification TPS Manifest Specification.
          p=l-1=Certain requirements necessitate the specification of mandatory whitespace. This is indicated by `
          p=l-1=' in the requirement text.
          p=l-1=The following technical terms used throughout this document are defined in the official TR_2d_Glossary AUTOSAR Glossary or TPS_2d_ManifestSpecification TPS Manifest Specification -- they are repeated here for tracing purposes.
          table tgroup=tbody=[[p=l-1=e=Term, p=l-1=e=Description], [p=l-1=tt=Application, p=l-1=An implementation that resolves a set of coherent functional requirements and is the result of functional development. An Application is the unit of delivery for Machine specific configuration and integration.], [p=l-1=tt=Executable, p=l-1=Part of an Application. It consists of executable code (with exactly one entry point) created at integation time that can be deployed and installed on a Machine. An Application may consist of one or more Executable, each of which can be deployed to different Machine.], [p=l-1=tt=Process, p=l-1=A Process is an instance of an Executable to be executed on a Machine and has a 1:1 association with the ARXML/Meta-Model element with the same name. This document also uses the term process (without a capital "P") to refer to the OS concept of a running process. Attention: Process != process. Hence each Process has at some time a related process but a process may not always have a related Process.], [p=l-1=tt=Reporting Process, p=l-1=A type of Process with an associated Executable where Executable.reportingBehavior is omitted (TPS_MANI_01279) or set to ExecutionStateReportingBehaviorEnum.reportsExecutionState. Such a Process is expected to report its Execution State to Execution Management.], [p=l-1=tt=Non-reporting Process, p=l-1=A type of Process with an associated Executable where Executable.reportingBehavior set to ExecutionStateReportingBehaviorEnum.doesNotReportExecutionState. Such a Process is not expected to report its Execution State to Execution Management.], [p=l-1=tt=Self-terminating Process, p=l-1=A type of Process that self initiate termination procedure, please note that for a standard Process this procedure is initiated by Execution Management.], [p=l-1=tt=Execution Dependency, p=l-1=Dependencies between Executable instances can be configured to define a sequence for starting and terminating them.], [p=l-1=tt=Execution Management, p=l-1=The element of the AUTOSAR Adaptive Platform responsible for the ordered startup and shutdown of the AUTOSAR Adaptive Platform and the Application.], [p=l-1=tt=State Management, p=l-1=The element of AUTOSAR Adaptive Platform defining modes of operation. It allows flexible definition of functions which are active on the platform at any given time.], [p=l-1=tt=Function Group, p=l-1=A Function Group is a set of coherent Process, which need to be controlled consistently. Depending on the state of the Function Group, Process are started or terminated. Process can belong to more than one Function Group State (but at exactly one Function Group). "MachineState" is a Function Group with a predefined name, which is mainly used to control Machine lifecycle and Process of platform level Application. Other Function Group are sort of general purpose tools used (for example) to control Process of user level Application.], [p=l-1=tt=Function Group State, p=l-1=The state of a Function Group (except "MachineState"). It defines a set of active Application for any certain situation. The set of Function Group and their states is machine specific and is deployed as part of the Machine Manifest.], [p=l-1=tt=Machine State, p=l-1=The state of Function Group "MachineState" with some predefined states (Startup/Shutdown/Restart).], [p=l-1=tt=Time Determinism, p=l-1=The results of a calculation are guaranteed to be available before a given deadline.], [p=l-1=tt=Data Determinism, p=l-1=The results of a calculation only depend on the input data and are reproducible, assuming a given initial internal state.], [p=l-1=tt=Full Determinism, p=l-1=Combination of Time and Data Determinism.], [p=l-1=tt=Communication Management, p=l-1=A Functional Cluster within the Adaptive Platform Foundation], [p=l-1=tt=Execution Manifest, p=l-1=[Manifest, Adaptive Application, Execution Manifest, Machine, Executable, Executable, Process, Executable]], [p=l-1=tt=Machine Manifest, p=l-1=[Manifest, Machine, Machine Manifest, Executable, Process]], [p=l-1=tt=Operating System, p=l-1=Software responsible for managing Process on a Machine and for providing an interface to hardware resources.], [p=l-1=tt=ResourceGroup, p=l-1=Configuration element to enable restrictions on resources uses by Adaptive Application running in the group.], [p=l-1=tt=ExecutionClient, p=l-1=[Adaptive Application, Execution Management]], [p=l-1=tt=DeterministicClient, p=l-1=[Adaptive Application, Execution Management]], [p=l-1=tt=StateClient, p=l-1=[State Management, Execution Management, Function Group State, Machine State]], [p=l-1=tt=Platform Health Management, p=l-1=A Functional Cluster within the Adaptive Platform Foundation], [p=l-1=tt=Recovery Action, p=l-1=Actions defined by the integrator to control Adaptive Application error recovery.], [p=l-1=tt=Process State, p=l-1=Lifecycle state of a Process], [p=l-1=tt=Service Instance Manifest, p=l-1=[Manifest, Service, Adaptive Application]], [p=l-1=tt=Trusted Platform, p=l-1=An execution platform supporting a continuous chain of trust from boot through to application supporting authentication (that all code executed is from the claimed source) and integrity validation (that prevents tampered code/data from being executed).]]:
            table caption table_3a_Technical_20_Terms  # Technical Terms
          table tgroup=tbody=[[p=l-1=e=Term, p=l-1=e=Description], [p=l-1=tt=Adaptive Application, p=l-1=see TR_2d_Glossary AUTOSAR Glossary], [p=l-1=tt=Application, p=l-1=see TR_2d_Glossary AUTOSAR Glossary], [p=l-1=tt=AUTOSAR Adaptive Platform, p=l-1=see TR_2d_Glossary AUTOSAR Glossary], [p=l-1=tt=Adaptive Platform Foundation, p=l-1=see TR_2d_Glossary AUTOSAR Glossary], [p=l-1=tt=Adaptive Platform Services, p=l-1=see TR_2d_Glossary AUTOSAR Glossary], [p=l-1=tt=Manifest, p=l-1=see TR_2d_Glossary AUTOSAR Glossary], [p=l-1=tt=Executable, p=l-1=see TR_2d_Glossary AUTOSAR Glossary], [p=l-1=tt=Functional Cluster, p=l-1=see TR_2d_Glossary AUTOSAR Glossary], [p=l-1=tt=Machine, p=l-1=see TR_2d_Glossary AUTOSAR Glossary], [p=l-1=tt=Service, p=l-1=see TR_2d_Glossary AUTOSAR Glossary], [p=l-1=tt=Service Interface, p=l-1=see TR_2d_Glossary AUTOSAR Glossary], [p=l-1=tt=Service Discovery, p=l-1=see TR_2d_Glossary AUTOSAR Glossary]]:
            table caption table_3a_Glossary_20_Defined_20_Technical_20_Terms  # Glossary-defined Technical Terms
        chap_3a_RelatedDocumentation  # Related documentation
          chapter sec_3a_InputDocs: p=l-1=The main documents that serve as input for the specification of the Execution Management are:, msr-query-topic-1=msr-query-props={msr-query-name=ARBibliography, msr-query-arg=autosar_noheader}  # Input documents & related standards and norms
          chapter chap_3a_Furher_appble_speion__49a528e5: p=l-1=AUTOSAR provides a general specification SWS_2d_General which is also applicable for Execution Management. The specification SWS General shall be considered as additional and required specification for implementation of Execution Management.  # Further applicable specification
        chap_3a_Constraints  # Constraints and assumptions
          chapter chap_3a_KnownLimitations:  # Known Limitations
            p=l-1=The following functionality is mentioned within this document but is not fully specified in this release:
            labeled-list=labeled-item={item-label=l-2=Section sect_3a_Resources Resource Limitation and Section sect_3a_EMFaultTolerance Fault Tolerance, p=l-1=-- these sections have been expanded in this release but are not complete. In particular the contents will be expanded with more properties and formal requirements in the next release.}
            p=l-1=The following functionality is not specified in this release:
            list=item=p=l-1=Support of a Trusted Platform (RS_EM_00014).
            p=l-1=Section chap_3a_NotApplicableReqs details requirements from Execution Management Requirement Specification RS_2d_RSExecutionManagement that are not elaborated within this specification. The presence of these requirements in this document ensures that the requirement tracing is complete and also provides an indication of how Execution Management will evolve in future releases of the AUTOSAR Adaptive Platform.
            p=l-1=The functionality described above is subject to modification and will be considered for inclusion in a future release of this document.
            l-1 tt=Execution Management, tt=AUTOSAR Adaptive Platform, tt=Execution Management, tt=AUTOSAR Adaptive Platform:
              xref target sec_3a_Limitations
        chap_3a_Dependencies: p=l-1=[Execution Management, SWS_2d_OperatingSystemInterface, Application, Application], p=l-1={tt=Execution Management, tt=SWS_2d_OperatingSystemInterface, xref=sec_3a_CoreAffinity}, p=l-1=[Execution Management, SWS_2d_Persistency], p=l-1=[Execution Management, SWS_2d_PlatformHealthManagement, Execution Management, Process]  # Dependencies to other Functional Clusters
          chapter chap_3a_Procol_layer_depies__8200cbc2: p=l-1=None.  # Protocol layer dependencies
        chap_3a_RequirementsTracing: p=l-1=The following tables reference the requirements specified in RS_2d_RSExecutionManagement and links to the fulfillment of these. Please note that if column ``Satisfied by'' is empty for a specific requirement this means that this requirement is not fulfilled by this document., table=tgroup={thead=row=[p=l-1=e=Requirement, p=l-1=e=Description, p=l-1=e=Satisfied by], tbody=[[p=l-1=tt=RS_AP_00115, p=l-1=Namespaces., p=l-1=SWS_EM_NA], [p=l-1=tt=RS_AP_00124, p=l-1=Variable names., p=l-1=SWS_EM_NA], [p=l-1=tt=RS_AP_00130, p=l-1=AUTOSAR Adaptive Platform shall represent a rich and modern programming environment., p=l-1=[SWS_EM_02246, SWS_EM_02247, SWS_EM_02248, SWS_EM_02249]], [p=l-1=tt=RS_AP_00132, p=l-1=noexcept behavior of API functions, p=l-1=SWS_EM_NA], [p=l-1=tt=RS_EM_00002, p=l-1=[Execution Management, Process], p=l-1=[SWS_EM_01014, SWS_EM_01015, SWS_EM_01041, SWS_EM_01042, SWS_EM_01043]], [p=l-1=tt=RS_EM_00005, p=l-1=[Execution Management, Process, Process], p=l-1=[SWS_EM_02102, SWS_EM_02103, SWS_EM_02106, SWS_EM_02107, SWS_EM_02108, SWS_EM_02109]], [p=l-1=tt=RS_EM_00008, p=l-1=tt=Execution Management, p=l-1=SWS_EM_02104], [p=l-1=tt=RS_EM_00009, p=l-1=[Execution Management, Process], p=l-1=[SWS_EM_01030, SWS_EM_01033]], [p=l-1=tt=RS_EM_00010, p=l-1=[Execution Management, Executable], p=l-1=[SWS_EM_01012, SWS_EM_01072, SWS_EM_01073, SWS_EM_01074, SWS_EM_01075, SWS_EM_01076, SWS_EM_01077, SWS_EM_02246, SWS_EM_02247, SWS_EM_02248, SWS_EM_02249]], [p=l-1=tt=RS_EM_00011, p=l-1=[Execution Management, Process], p=l-1=[SWS_EM_01404, SWS_EM_01405]], [p=l-1=tt=RS_EM_00013, p=l-1=tt=Execution Management, p=l-1=[SWS_EM_01016, SWS_EM_01062, SWS_EM_01063, SWS_EM_01064, SWS_EM_02076, SWS_EM_02077, SWS_EM_02257, SWS_EM_02261, SWS_EM_02262]], [p=l-1=tt=RS_EM_00014, p=l-1=tt=Execution Management, p=l-1=[SWS_EM_02299, SWS_EM_02300, SWS_EM_02301, SWS_EM_02302, SWS_EM_02303, SWS_EM_02304, SWS_EM_02305, SWS_EM_02306, SWS_EM_02307, SWS_EM_02308, SWS_EM_02309, SWS_EM_NA]], [p=l-1=tt=RS_EM_00050, p=l-1=[Execution Management, Machine, Process], p=l-1=SWS_EM_NA], [p=l-1=tt=RS_EM_00051, p=l-1=[Execution Management, Process], p=l-1=SWS_EM_NA], [p=l-1=tt=RS_EM_00052, p=l-1=[Execution Management, Process], p=l-1=[SWS_EM_01301, SWS_EM_01302, SWS_EM_01303, SWS_EM_01304, SWS_EM_01351, SWS_EM_01352, SWS_EM_01353, SWS_EM_02201, SWS_EM_02210, SWS_EM_02211, SWS_EM_02215, SWS_EM_02216]], [p=l-1=tt=RS_EM_00053, p=l-1=[Execution Management, Process, Process], p=l-1=[SWS_EM_01305, SWS_EM_01306, SWS_EM_01308, SWS_EM_01310, SWS_EM_01311, SWS_EM_01312, SWS_EM_01313, SWS_EM_02202, SWS_EM_02211, SWS_EM_02215, SWS_EM_02220, SWS_EM_02225, SWS_EM_02230, SWS_EM_02235]], [p=l-1=tt=RS_EM_00100, p=l-1=[Execution Management, Process], p=l-1=[SWS_EM_01000, SWS_EM_01001, SWS_EM_01050, SWS_EM_01051]], [p=l-1=tt=RS_EM_00101, p=l-1=[Execution Management, State Management], p=l-1=[SWS_EM_01013, SWS_EM_01023, SWS_EM_01024, SWS_EM_01025, SWS_EM_01032, SWS_EM_01033, SWS_EM_01060, SWS_EM_01065, SWS_EM_01066, SWS_EM_01067, SWS_EM_01107, SWS_EM_01109, SWS_EM_01110, SWS_EM_02070, SWS_EM_02241, SWS_EM_02242, SWS_EM_02245, SWS_EM_02250, SWS_EM_02251, SWS_EM_02253, SWS_EM_02254, SWS_EM_02255, SWS_EM_02258, SWS_EM_02259]], [p=l-1=[SWS_EM_02260, SWS_EM_02269, SWS_EM_02270, SWS_EM_02271, SWS_EM_02272, SWS_EM_02273, SWS_EM_02274, SWS_EM_02275, SWS_EM_02276, SWS_EM_02277, SWS_EM_02278, SWS_EM_02279, SWS_EM_02297, SWS_EM_02298]], [p=l-1=tt=RS_EM_00103, p=l-1=[Execution Management, Process], p=l-1=[SWS_EM_01002, SWS_EM_01003, SWS_EM_01004, SWS_EM_01006, SWS_EM_01055, SWS_EM_01071, SWS_EM_01401, SWS_EM_01402, SWS_EM_01403, SWS_EM_01404, SWS_EM_01405, SWS_EM_02000, SWS_EM_02001, SWS_EM_02002, SWS_EM_02003, SWS_EM_02030, SWS_EM_02243, SWS_EM_02244]], [p=l-1=tt=RS_EM_00111, p=l-1=[Execution Management, Process, Machine], p=l-1=SWS_EM_NA], [p=l-1=tt=RS_EM_NA, p=l-1=SWS_EM_NA]]}  # Requirements traceability
          chapter chap_3a_NotApplicableReqs  # Not applicable requirements
            trace SWS_EM_NA: category=SPECIFICATION_ITEM, p=l-1=These requirements are not applicable as they are not within the scope of this release.
        chap_3a_EMFuncSpec:  # Functional specification
          p=l-1=[Execution Management, Adaptive Platform Foundation, Execution Management, Application]
          p=l-1=[Execution Management, Execution Management, Application]
          p=l-1=This chapter describes the functional behavior of Execution Management.
          list=[p=l-1=Section sect_3a_TechnicalOverview presents an introduction to key terms within Execution Management focusing on the relationship between Application, Executable, and Process., p=l-1=Section chap_3a_EMLifeCycle covers the core Execution Management run-time responsibilities including the start of Application., p=l-1=Section chap_3a_ApplicationLifeCycleMgmt describes the lifecycle of Application including Process state transitions and startup / shutdown sequences., p=l-1=Section sect_3a_EMMachineStateManagement covers several topics related to State Management within Execution Management including execution, Machine and Function Group state management., p=l-1=Section sect_3a_ApplicationRecoveryActions describes how Application error recovery actions are specified during integration., p=l-1=Section sec_3a_DetExecFull documents support provided by Execution Management Deterministic execution such that given the same input and internal state, a calculation will always produce the same output., p=l-1=Section sect_3a_Resources describes how Execution Management supports resource management including the limitation of usage of CPU and memory by an Application., p=l-1=Section sect_3a_EMFaultTolerance provides an introduction to Fault Tolerance strategies in general. This section will be expanded in a future release to describe how such strategies are realized within Execution Management., p=l-1=Section sect_3a_EMSecurity covers the topic of Trusted Platform, i.e. ensuring the integrity and authenticity of Application.]
          10 x chapter:
            sect_3a_FunctionalClusterLifecyle  # Functional Cluster Lifecyle
              chapter chap_3a_Statup__1a486839: p=l-1=See Section sec_3a_MSStartup.  # Startup
              chapter chap_3a_Shuown__90e868d3: p=l-1=See Section sec_3a_MSShutdown.  # Shutdown
              chapter chap_3a_Resar__bffd4641: p=l-1=See Section sec_3a_MSRestart.  # Restart
            sect_3a_TechnicalOverview: p=l-1=This chapter presents a short summary of the relationship between Application, Executable, and Process.  # Technical Overview
              7 x chapter:
                chap_3a_Appion__17ad7937:  # Application
                  p=l-1=[Application, Application]
                  p=l-1=[Application, Executable, AUTOSAR Adaptive Platform, constr_1605, TPS_2d_ManifestSpecification]
                  p=l-1=In general, an Application, whether user-level or platform-level, is treated the same by Execution Management and can use all mechanisms and APIs provided by the Operating System and other functional clusters of the AUTOSAR Adaptive Platform. However in doing so it potentially restricts its portability to other implementations of the AUTOSAR Adaptive Platform.
                chap_3a_Adaive_Appion__96bf3a71:  # Adaptive Application
                  p=l-1=An Adaptive Application is a specific type of Application. The implementation of an Adaptive Application fully complies with the AUTOSAR specification, i.e. it is restricted to the use of APIs standardized by AUTOSAR and needs to follow specific coding guidelines to allow reallocation between different implementations of the AUTOSAR Adaptive Platform.
                  p=l-1=[Adaptive Application, Application, Adaptive Application]
                  p=l-1=Figure fig_3a_Applications shows the different types of Applications.
                  p=l-1=An Adaptive Application is the result of functional development and is the unit of delivery for Machine specific configuration and integration. Some contracts (e.g. concerning used libraries) and Service Interface to interact with other Adaptive Application need to be agreed on beforehand. For details see TR_2d_AdaptiveMethodology.
                  figure caption fig_3a_Applications  # Types of Applications
                chap_3a_Exeble__5404ed7d:  # Executable
                  p=l-1=An Executable is a software unit which is part of an Application. It has exactly one entry point (main function) SWS_OSI_01001. An Application can be implemented in one or more Executable TPS_MANI_01010.
                  p=l-1=The lifecycle of Executable usually consists of:
                  p=l-1=[Executable, Adaptive Application, Machine, Machine, Machine]
                  p=l-1=Figure fig_3a_ExecutableLifecycle shows the lifecycle of an Executable from deployment to execution.
                  table tgroup=tbody=[[p=l-1=e=Process Step, p=l-1=e=Software, p=l-1=e=Meta Information], [p=l-1=Development and Integration, p=l-1=Linked, configured and calibrated binary for deployment onto the target Machine. The binary might contain code which was generated at integration time., p=l-1={tt=Execution Manifest, xref=sect_3a_ExecutionManifest, tt=TPS_2d_ManifestSpecification, tt=Service Instance Manifest}], [p=l-1=Deployment and Removal, p=l-1=Binary installed on the target Machine. Previous version (if any) removed., p=l-1=Processed Manifests, stored in a platform-specific format which is efficiently readable at Machine startup.], [p=l-1=Execution, p=l-1=tt=Process, p=l-1=The Execution Management uses contents of the Processed Manifests to start up and configure each Process individually.]]:
                    table caption table_3a_Executable_20_Lifecycle  # Executable Lifecycle
                  figure caption fig_3a_ExecutableLifecycle  # Executable Lifecycle from deployment to execution
                chap_3a_Proess__8efe9ead:  # Process
                  p=l-1=A Process is an instance of an Executable. On the AUTOSAR Adaptive Platform, a Process is realized at run-time as an OS process. For details on how Execution Management starts and stops Process see chap_3a_ApplicationLifeCycleMgmt.
                  p=l-1=[Execution Management, Executable, Process, Application]
                  p=l-1={e=Remark:, tt=Process, tt=Execution Management, tt=Process, tt=Process, tt=Execution Management, tt=Process, tt=State Management, xref=sect_3a_EMMachineStateManagement, xref=sec_3a_DetExeCyclicDetExe}
                sect_3a_ExecutionManifest:  # Execution Manifest
                  p=l-1=An Execution Manifest is created together with a Service Instance Manifest (not used by Execution Management) at design time and deployed onto a Machine together with the Executable it is attached to.
                  p=l-1=The Execution Manifest specifies the deployment related information of an Executable and describes in a standardized way the machine-specific configuration of Process properties (startup parameters, resource group assignment, scheduling priorities etc.).
                  p=l-1=The Execution Manifest is bundled with the actual executable code in order to support the deployment of the executable code onto the Machine.
                  p=l-1=Each instance of an Executable binary, i.e. each started Process, is individually configurable, with the option to use a different configuration set per Machine State or per Function Group State (see Section sect_3a_EMMachineStateManagement and TPS_MANI_01012, TPS_MANI_01013, TPS_MANI_01014, TPS_MANI_01015, TPS_MANI_01059, TPS_MANI_01017 and TPS_MANI_01041).
                  p=l-1=To perform its necessary actions, Execution Management imposes a number of requirements on the content of the Execution Manifest.
                  p=l-1=For more information regarding the Execution Manifest specification please see TPS_2d_ManifestSpecification.
                chap_3a_Macine_Manest__69aa49be: p=l-1=The Machine Manifest is also created at integration time for a specific Machine and is deployed like Execution Manifest whenever its contents change. The Machine Manifest holds all configuration information which cannot be assigned to a specific Executable or its instances (the Process), i.e. which is not already covered by an Execution Manifest or a Service Instance Manifest., p=l-1=The contents of a Machine Manifest includes the configuration of Machine properties and features (resources, safety, security, etc.), e.g. configured Machine State and Function Group State, resource groups, access right groups, scheduler configuration, SOME/IP configuration, memory segmentation. For details see TPS_2d_ManifestSpecification.  # Machine Manifest
                chap_3a_Manest_Format__36482727: p=l-1=The Execution Manifest and the Machine Manifest can be transformed from the original standardized ARXML into a platform-specific format (called Processed Manifest), which is efficiently readable at Machine startup. The format transformation can be done either off board at integration time or at deployment time, or on the Machine (by Update and Configuration Management) at installation time.  # Manifest Format
            chap_3a_EMLifeCycle:  # Execution Management Responsibilities
              p=l-1=[Execution Management, Process, Process, Executable, Application, Execution Management, AUTOSAR Adaptive Platform, Process, Execution Management, Process, Executable, Machine Manifest, Execution Manifest]
              p=l-1={tt=Execution Management, tt=Executable, tt=Executable, tt=Execution Management, xref=sect_3a_EMSecurity}
              p=l-1=The mechanism by which the restriction of SWS_EM_01030 is implementation-specific, but could be realized by configuring the process capability attribute mask at the time of process creation.
              p=l-1=Depending on the Machine State or on any other Function Group State, deployed Executable are started during AUTOSAR Adaptive Platform startup or later, however it is not expected that all will begin active work immediately since many Process will provide services to other Process and therefore wait and ``listen'' for incoming service requests.
              p=l-1={tt=Execution Management, tt=Executable, tt=Execution Dependency, trace=SWS_EM_01050, tt=Execution Manifest, tt=TPS_MANI_01041}
              p=l-1={tt=Execution Management, e=not, tt=Process, tt=SWS_OSI_01003, tt=Execution Management, tt=Execution Management, tt=Machine Manifest, tt=Execution Manifest}
              trace SWS_EM_01030: category=SPECIFICATION_ITEM, p=l-1=[Execution Management, Process]  # Restriction of process creation right for Processes
            chap_3a_ApplicationLifeCycleMgmt  # Process Lifecycle Management
              4 x chapter:
                sec_3a_ExecutionState:  # Execution State
                  p=l-1={e=Execution States, tt=Process, tt=Process, tt=Process, tt=ExecutionState}
                  p=l-1=[Execution Management, Process, ExecutionState.kRunning, Process]
                  p=l-1=Please note that Service Discovery can introduce non-deterministic delays and thus is advised to be done after reporting ExecutionState.kRunning state. This implies that the Process may not have completed all its initialization when the ExecutionState.kRunning state is reported by the Process, using the ExecutionClient::ReportExecutionState interface.
                  p=l-1=Note that from the perspective of Execution Management, requirement SWS_EM_01055 only requests the initiation of the steps necessary for termination.
                  p=l-1=On receipt of SIGTERM, a Reporting Process acknowledges the request (by reporting ExecutionState.kTerminating to Execution Management using the ExecutionClient::ReportExecutionState interface) and then commences the actual termination. A Reporting Process initiates self-termination by reporting the ExecutionState.kTerminating state to Execution Management.
                  p=l-1=During the Terminating state, the Process is expected to save persistent data and free all internally used resources. The Process indicates completion of the Terminating state by simply exiting (with an appropriate exit code).
                  p=l-1={tt=Execution Management, tt=Process, tt=Execution Management, tt=Process, tt=Process, e=Terminated, tt=Process}
                  p=l-1=Details on the response to ``fault'' error-codes, e.g. a non-zero exit code, will be defined in Section sect_3a_EMFaultTolerance in a future release of this document.
                  p=l-1=Correct Execution State reporting performed by Process is a part of consistent behavior of Execution Management.
                  p=l-1=Note that in SWS_EM_01065, Process termination timeout monitoring applies to all termination sequences including self-termination (Process reports Execution State Terminating without request by Execution Management) and termination requested by Execution Management.
                  p=l-1=Execution Management differentiates between two types of Process: Reporting Process and Non-reporting Process. Reporting Process are considered to be the normal form of Process and Non-reporting Process are considered to be an exception.
                  p=l-1=[Non-reporting Process, Executable, Executable, Executable]
                  p=l-1=In safety related systems the system designer has to use Non-reporting Process functionality with care. Such Process will probably not provide safety critical functionality and will not be monitored by Platform Health Management but still they might influence other safety related Process and therefore can introduce a safety risk. To isolate Non-reporting Process from safety critical parts ResourceGroup can be used (see Section sect_3a_Resources).
                  figure caption fig_3a_ExecutionStates  # Execution States
                  6 x trace, all with category=SPECIFICATION_ITEM:
                    SWS_EM_01055: p=l-1={tt=Execution Management, tt=Process, e=SIGTERM, tt=Process}  # Initiation of Process termination
                    SWS_EM_01071: p=l-1=[Execution Management, Reporting Process, ExecutionState.kTerminating]  # Premature Termination of a Reporting Process
                    SWS_EM_02243: p=l-1=After Process creation, Execution Management shall ignore duplicate Execution State Running reports triggered by a specific Process.  # Handling Execution State Running
                    SWS_EM_02244: p=l-1=After initiation of Process termination, Execution Management shall ignore duplicate Execution State Terminating reports and inconsistent backward Execution State Running transition reports triggered by a specific Process.  # Handling Execution State Terminating
                    SWS_EM_01402: p=l-1=For Non-reporting Process the transition from Starting to Running Process State shall implicitly apply after Execution Management has allocated the required resources and created the run-time process.  # Implicit Running Process State
                    SWS_EM_01403: p=l-1={tt=Execution Management, e=Execution State, tt=Non-reporting Process}  # Reporting Non-reporting Process
                sec_3a_ProcessStates:  # Process States
                  p=l-1={e=Process States, tt=Process, tt=Execution Management, tt=Execution Management, e=Execution States, xref=sec_3a_ExecutionState, tt=Process, e=Process State}
                  p=l-1=The ExecutionState.kTerminating and ExecutionState.kRunning Execution State indications from Process to Execution Management use the ExecutionClient::ReportExecutionState API (see Section sec_3a_api_em_ExecutionClient__ReportExecutionState).
                  p=l-1=For SWS_EM_01006, Execution Management observes the exit status of all Process. The mechanism is implementation dependent but could, for example, use the POSIX waitpid() API.
                  p=l-1=From the resource allocation point of view, the Terminated Process State is similar to the Idle Process State -- there is no Process running and no resources are allocated. However from the execution point of view, the Terminated Process State is different from Idle as it tells Execution Management that the Process has already been executed, terminated and can be now restarted (if needed) as specified in SWS_EM_01066.
                  figure caption fig_3a_Process_20_States  # Process Lifecycle
                  7 x trace, all with category=SPECIFICATION_ITEM:
                    SWS_EM_01401: p=l-1=The AdaptivePlatform implementation shall only allow a Process to report its own ExecutionState.  # Process Self Reporting
                    SWS_EM_01002: p=l-1=The Idle Process State shall be the Process State prior to creation of the Process and to resource allocation.  # Idle Process State
                    SWS_EM_01003: p=l-1=The Starting Process State shall apply when the Process has been created and resources have been allocated.  # Starting Process State
                    SWS_EM_01004: p=l-1=The Running Process State shall apply to a Reporting Process after it has reported ExecutionState.kRunning Execution State to Execution Management.  # Running Process State of Reporting Processes
                    SWS_EM_01404: p=l-1=The Terminating Process State shall apply when Execution Management sent SIGTERM signal to the Process.  # Terminating Process State after Termination Request
                    SWS_EM_01405: p=l-1=The Terminating Process State shall apply when the Reporting Process has decided to self-terminate and informed Execution Management by reporting ExecutionState.kTerminating Execution State.  # Terminating Process State after Terminating Report
                    SWS_EM_01006: p=l-1=The Terminated Process State shall apply after the Process has terminated and the Process resources have been freed.  # Terminated Process State
                sec_3a_Startup_shutdown  # Startup and Termination
                  chapter chap_3a_Ording__f2b831f4:  # Ordering
                    p=l-1=[Execution Management, Process, State Management, Execution Dependency]
                    p=l-1=An Execution Dependency defines the provider of functionality required by a Process necessary for that Process to provide its own functionality. Execution Management ensures the dependent Process are in the state defined by the Execution Dependency before the Process defining the dependency is started.
                    p=l-1=When considering dependencies on Service it is tempting to use Execution Dependency. However general Service Discovery is a better mechanism as services can go ON or OFF at any time and the Process are expected to cope with this situation. Please note that Execution Dependency may be used to reduce service discovery delays.
                    p=l-1=[Execution Dependency, TPS_MANI_01041, constr_1606, Execution Manifest]
                    p=l-1=The same Execution Dependency used to define the startup order are also used to define the termination order. However the situation is reversed as Execution Management is required to ensure that dependent Process are terminated after the Process to ensure that the services required remain available until no longer required.
                    p=l-1=Note that SWS_EM_01051 merely requires Execution Management to not terminate the dependent Process before terminating a Process. It is not an error if the Process has self-terminated so is not available to be terminated.
                    p=l-1=If no Execution Dependency are specified between two Process then no order is imposed and they can be started or terminated in an arbitrary order.
                    p=l-1=The required dependency information is provided by the Application developer. It is adapted to the specific Machine environment at integration time and made available in the Execution Manifest.
                    p=l-1={tt=Execution Management, tt=Process, e=Process State, tt=Process, trace=SWS_EM_01050}
                    note p=l-1=Consider a Process, DataLogger, which has an Execution Dependency on another Process, Storage. For startup this means DataLogger has a Execution Dependency on Storage so the latter is required to be started by Execution Management before DataLogger so that DataLogger can store its data.:
                      l-1:
                        xref target Execution_20_Dependency_20_Use_2d_case_20__2d__20_Startup
                    trace SWS_EM_01050: category=SPECIFICATION_ITEM, p=l-1=During startup of a Process, Execution Management shall respect Execution Dependency by ensuring that any Process upon which the Process to be started depends have reached the requested Process State before starting the Process.  # Start Dependent Processes
                    trace SWS_EM_01051: category=SPECIFICATION_ITEM, p=l-1=During termination of a Process, Execution Management shall respect Execution Dependency by ensuring that any Process upon which the Process to be terminated depends are not terminated before termination of the Process.  # Termination of Processes
                    note p=l-1=Consider the same Process, DataLogger, as above which has an Execution Dependency on another Process, Storage. For termination the Execution Dependency indicates Execution Management is required to only termination Storage after DataLogger so the latter can flush its data during termination.:
                      l-1:
                        xref target Execution_20_Dependency_20_Use_2d_case_20__2d__20_Termination
                  chapter chap_3a_Argnts__5e98ea90:  # Arguments
                    p=l-1=[Execution Management, Process, StateDependentStartupConfig, Process, Process.stateDependentStartupConfig, Process]
                    p=l-1=Note that SWS_EM_01012 deliberately does not specify the OS mechanism used to start a Process, e.g. the exec-family based POSIX interface, as this is ultimately an implementation specific property.
                    p=l-1=The first argument on the command-line passed by Execution Management is the name of the Executable.
                    p=l-1=[Execution Management, Process, StartupOption, StartupOption.optionName, Process, StartupOption, StartupOption.optionKind, CommandLineOptionKindEnum.commandLineSimpleForm]
                    p=l-1={tt=Execution Management, e=-, tt=StartupOption, tt=StartupOption.optionName}
                    p=l-1=Note that requirement SWS_EM_01074 includes the specification of mandatory whitespace; this is indicated by `
                    p=l-1=' in the requirement text.
                    p=l-1={tt=Execution Management, e=-, e=-, tt=StartupOption, tt=StartupOption.optionName}
                    7 x trace, all with category=SPECIFICATION_ITEM:
                      SWS_EM_01012: p=l-1=At the initiation of startup of a Process, the aggregated StartupOptions of the StartupConfig referenced by the StateDependentStartupConfig shall be passed to the Process by Execution Management based on SWS_EM_01072, SWS_EM_01073, SWS_EM_01074, SWS_EM_01075, SWS_EM_01076 and SWS_EM_01077.  # Process Argument Passing
                      SWS_EM_01072: p=l-1=Argument 0 shall be set to name of the Executable.  # Process Argument Zero
                      SWS_EM_01073: p=l-1=For each aggregated StartupOption at position n with StartupOption.StartupOption.optionKind = CommandLineOptionKindEnum.commandLineSimpleForm the nth argument shall be StartupOption.StartupOption.optionArgument.  # Simple Arguments
                      SWS_EM_01074: p=l-1=For each aggregated StartupOption at position n with StartupOption.StartupOption.optionKind = CommandLineOptionKindEnum.commandLineShortForm and with multiplicity of StartupOption.StartupOption.optionArgument = 1 the nth argument shall be '-' + StartupOption.StartupOption.optionName + ', p=l-1=' + StartupOption.StartupOption.optionArgument  # Short form arguments with option value
                      SWS_EM_01075: p=l-1=For each aggregated StartupOption at position n with StartupOption.StartupOption.optionKind = CommandLineOptionKindEnum.commandLineShortForm and with multiplicity of StartupOption.StartupOption.optionArgument = 0 the nth argument shall be '-' + StartupOption.StartupOption.optionName  # Short form Arguments without option value
                      SWS_EM_01076: p=l-1=For each aggregated StartupOption at position n with StartupOption.StartupOption.optionKind = CommandLineOptionKindEnum.commandLineLongForm and with multiplicity of StartupOption.StartupOption.optionArgument = 1 the nth argument shall be '--' + StartupOption.StartupOption.optionName + '=' + StartupOption.StartupOption.optionArgument  # Long form Arguments with option value
                      SWS_EM_01077: p=l-1=For each aggregated StartupOption at position n with StartupOption.StartupOption.optionKind = CommandLineOptionKindEnum.commandLineLongForm and with multiplicity of StartupOption.StartupOption.optionArgument = 0 the nth argument shall be '--' + StartupOption.StartupOption.optionName  # Long form Arguments without option value
                  chapter chap_3a_Envent_Varles__f1207de9: p=l-1={tt=Execution Management, tt=Process, tt=Process, tt=Execution Manifest, tt=Machine, tt=Machine Manifest, e=getenv()}, p=l-1=Please note that AUTOSAR meta model (see TPS_2d_ManifestSpecification) uses TagWithOptionalValue for environment variables definition (TPS_MANI_01208 and TPS_MANI_01209). As explained there, the value (TagWithOptionalValue.TagWithOptionalValue.value) can be omitted as a way of specifying environment variable with empty value.  # Environment Variables
                    4 x trace, all with category=SPECIFICATION_ITEM:
                      SWS_EM_02246: p=l-1=[Execution Management, Process, Process.stateDependentStartupConfig, StateDependentStartupConfig.startupConfig, StartupConfig.environmentVariable, Process]  # Process specific Environment Variables
                      SWS_EM_02247: p=l-1=[Execution Management, Machine, Machine.environmentVariable, Process]  # Machine specific Environment Variables
                      SWS_EM_02249: p=l-1=Whenever Execution Management finds environment variable definition, that have TagWithOptionalValue.TagWithOptionalValue.value missing, it should use empty string as a value for this environment variable.  # Missing value from Environment Variable definition
                      SWS_EM_02248: p=l-1=Whenever the same environment variable is configured within both the Execution Manifest and the Machine Manifest then Execution Management shall use the environment variable value from the Execution Manifest.  # Environment Variables precedence
                sub_3a_Startup_20_sequence:  # Startup Sequence
                  p=l-1=When the Machine is started, Execution Management is launched as the Machine's first process. Other functional clusters and platform-level Application of the Adaptive Platform Foundation and Adaptive Platform Services are then launched by Execution Management. After the Adaptive Platform Foundation and Adaptive Platform Services are up and running, Execution Management continues to launch user-level Application.
                  p=l-1=Please note that an Application consists of one or more Executable. Therefore to launch an Application, Execution Management starts Process as instances of each Executable.
                  p=l-1=Please see Section sect_3a_ExecutionManifest.
                  p=l-1=Figure fig_3a_startup shows the overall startup sequence.
                  trace SWS_EM_01000: category=SPECIFICATION_ITEM, p=l-1=The startup order of the platform-level Process shall be determined by Execution Management based on Machine Manifest and Execution Manifest information.  # Startup order
                  figure caption fig_3a_startup  # Startup sequence
                  chapter chap_3a_Exeion_Depncy__185c48c8:  # Execution Dependency
                    p=l-1=The Execution Dependency, see TPS_MANI_01041 and constr_1606 , are configured in the Execution Manifest, which is created at integration time based on information provided by the Application developer.
                    p=l-1=User-level Application are expected to use the service discovery mechanisms of Communication Management as the primary mechanism for execution sequencing as this is supported both within a Machine and across Machine boundaries. Thus user-level applications should not rely on Execution Dependency unless strictly necessary. Which Process are running depends on the current Function Group State, including the Machine State, see Section sect_3a_EMMachineStateManagement. The integrator should ensure that all service dependencies are mapped to State Management configuration, i.e. that all dependent Process are running when needed. In real life, specifying a simple dependency to a Process might not be sufficient to ensure that the depending service is actually provided. Since some Process shall reach a certain Execution State (see Section sec_3a_ExecutionState) to be able to offer their services to other Process, the dependency information shall also refer to Process State of the Process specified as dependency. With that in mind, the dependency information may be represented as a pair like: <Process>.<ProcessState>. For more details regarding the Process States refer to Section sec_3a_ProcessStates.
                    p=l-1=The following dependency use-cases have been identified:
                    labeled-list=[{item-label=l-2=Dependency on Running Process State, p=l-1=In case Process B has a simple dependency on Process A, the Running Process State of Process A is specified in the dependency section of Process B's Execution Manifest. When Process B has a Running Execution Dependency to Process A, then Process B will only be started once the Process A reports Running state to the EM.}, {item-label=l-2=Dependency on Terminated Process State, p=l-1=In case Process D depends on Self-terminating Process C, the Terminated Process State of Process C is specified in the dependency section of Process D's Execution Manifest., p=l-1=If Process D has Terminated Execution Dependency on Process C, then Process D will only be started once Process C reaches the Terminated state., p=l-1=If a Terminated Execution Dependency is specified on a non self-terminating Process then it will, by definition, time-out as the mentioned Process will not terminate until the next Function Group transition.}]
                    p=l-1={e=Note:, tt=Execution Dependency, e=Idle, e=Terminating, tt=Execution Dependency}
                    p=l-1=The Executable.version information within the Execution Manifest is available for use during integration to ensure that a consuming Executable and its required services are compatible with the producing Executable and its provided services. This also applies to the Process which are instantiated from these Executable. An example for the definition of the version information attached to several Executable can be found in Listing Figure fig_3a_exampleVersioning.
                    p=l-1=An example for the definition of the Execution Dependency information can be found in Listing Figure fig_3a_exampleDependency
                    p=l-1=[Process, Execution Management, Machine State, Function Group State, Execution Dependency, Execution Dependency]
                    p=l-1=Please note that requirement SWS_EM_01001 effectively forbids any Execution Dependency that spans outside of a single Function Group State (or a Machine State) definition, see also constr_1689. This is done on purpose, as this kind of dependencies will introduce hidden dependencies between Function Group and they will not be visible to State Management. If dependencies between Function Group needs to be expressed (e.g. mapping software could have dependency on GPS software), then this should be done inside State Management. For more information see SWS_2d_StateManagement.
                    p=l-1=Unlike a Reporting Process, a Non-reporting Process is in Execution State Running directly after start. Regardless of whether the Process has completed its initialization phase and is ready to offer its services or not. This means that Running Execution Dependencies do not work in combination with Non-reporting Process without further action.
                    p=l-1=This limitation can be overcome by introducing a companion Process, which acts as a representative of the Non-reporting Process. The companion waits for availability of the service provided by the Non-reporting Process and reports ExecutionState.kRunning to Execution Management. The Process which in fact need the services of the Non-reporting Process can be configured to be dependent on the companion Process. Please note that the Terminated Execution Dependency is not affected as Execution Management is informed by the Operating System when Non-reporting Processes are Terminated. This approach can also be used to communicate a Health State to Platform Health Management.
                    l-1 tt=Execution Management, tt=AUTOSAR Adaptive Platform, tt=Application, tt=Application, tt=Application, tt=Application:
                      xref target sub_3a_Execution_20_Dependency
                    msr-query-p-1 msr-query-props={msr-query-name=ARInputListing, msr-query-arg=DOC_Manifest_EMOExampleApplicationDependencies.arxml, msr-query-arg=ARListingXML, msr-query-arg=Example for Executable versions, msr-query-arg=fig_3a_exampleVersioning, msr-query-arg=10, msr-query-arg=30}:
                      msr-query-result-p-1:
                        figure caption fig_3a_exampleVersioning
                    msr-query-p-1 msr-query-props={msr-query-name=ARInputListing, msr-query-arg=DOC_Manifest_EMOExampleApplicationDependencies.arxml, msr-query-arg=ARListingXML, msr-query-arg=Example for Executable dependency, msr-query-arg=fig_3a_exampleDependency, msr-query-arg=41, msr-query-arg=69}:
                      msr-query-result-p-1:
                        figure caption fig_3a_exampleDependency
                    trace SWS_EM_01001: category=SPECIFICATION_ITEM, p=l-1=If Execution Management needs to start Process A that depends on another Process B and Process B is not part of the same Function Group State as Process A, then Execution Management shall return an error (and fail to start Process A).  # Execution Dependency error
                    note p=l-1=Let assume that Process ``A'' depends on the Running Process State of a Process ``B''. At a Machine State transition, Process ``A'' shall be started, because it references the new Machine State. However, Process ``B'' does not reference that Machine State, so it is not started. Due to the Execution Dependency between the two Process, Process ``A'' would never start running in the new Machine State because it waits forever for Process ``B''. This is considered to be a configuration error and shall also cause run time error.:
                      l-1:
                        xref target Execution_20_Dependency
            sect_3a_EMMachineStateManagement  # State Management
              5 x chapter:
                sec_3a_EMMachineStateManagementOverview:  # Overview
                  p=l-1=[State Management, AUTOSAR Adaptive Platform, Execution Management]
                  p=l-1=The Execution Manifest allows to define in which states the Process have to run (see TPS_2d_ManifestSpecification). As mentioned before, a Process is an instance of an Executable, which is part of an Application. State Management mechanisms grant full control over the set of Application to be executed and ensures that Process are only executed (and hence resources allocated) when actually needed.
                  p=l-1=Four different states are relevant for Execution Management:
                  labeled-list=[{item-label=l-2=Execution State, p=l-1=-- An Execution States characterizes the internal lifecycle of each started Process, see Section sec_3a_ExecutionState}, {item-label=l-2=Process State, p=l-1=-- Process States are managed by an Execution Management internal state machine. For details see Section sec_3a_ProcessStates.}, {item-label=l-2=Machine State, p=l-1=-- see Section sec_3a_MachineState}, {item-label=l-2=Function Group State, p=l-1=-- see Section sec_3a_EMFunctionGroupState}]
                  p=l-1=An example for the interaction between these states will be shown in section Section sec_3a_StateInteraction.
                sec_3a_MachineState:  # Machine State
                  p=l-1={tt=Execution Management, tt=Function Group, tt=Machine, tt=Function Group, e="MachineState", tt=Function Group State, tt=Machine State, tt=Machine State, tt=Machine}
                  p=l-1=The Function Group "MachineState" has several mandatory states (see SWS_EM_02250, SWS_EM_01024 and SWS_EM_01025) that are also expected to be configured for each machine. Additional Machine State can be defined on a machine specific basis and are therefore not standardized.
                  p=l-1=[Function Group State, Machine State, Process, Application, Execution Manifest, Function Group State, Process, ModeDeclaration, Machine State, Machine Manifest, constr_1687, TPS_MANI_03194]
                  p=l-1={tt=Machine State, tt=Function Group State, tt=State Management, xref=sec_3a_StateTransition}
                  p=l-1=The start-up sequence from initial state Startup to the point where State Management, SM, requests the initial running machine state StateXYZ is illustrated in Figure fig_3a_Sequence_Startup_to_Initial_Driving_State.
                  p=l-1=An arbitrary state change sequence to machine state StateXYZ is illustrated in Figure fig_3a_Sequence_Transition_to_Machine_State_StateXYZ. Here, on receipt of the state change request, Execution Management terminates running Process and then starts Process active in the new state before confirming the state change to State Management.
                  trace SWS_EM_01032: category=SPECIFICATION_ITEM, p=l-1={tt=Execution Management, tt=Function Group, e=MachineState, tt=Machine Manifest, tt=Machine State}  # Machine States configuration
                  figure caption fig_3a_Sequence_Startup_to_Initial_Driving_State  # Start-up Sequence -- from Startup to initial running state StateXYZ
                  figure caption fig_3a_Sequence_Transition_to_Machine_State_StateXYZ  # State Change Sequence -- Transition to machine state StateXYZ
                  chapter sec_3a_MSStartup: p=l-1=Please note that for Machine State transitions, the requirements of section Section sec_3a_StateTransition apply., p=l-1={tt=Execution Management, tt=Function Group State, trace=SWS_EM_01023, tt=State Management, tt=Machine State, tt=Startup, e=Shutdown, e=Restart, tt=Machine, tt=State Management, tt=Startup, tt=Machine State, tt=Machine, tt=Machine State, tt=State Management}  # Startup
                    4 x trace, all with category=SPECIFICATION_ITEM:
                      SWS_EM_02250: p=l-1={tt=Execution Management, tt=Startup, tt=Function Group, e="MachineState"}  # Machine State Startup
                      SWS_EM_01023: p=l-1=[Execution Management, Startup, Machine State, Execution Management]  # Self initiation of Machine State Startup transition
                      SWS_EM_02241: p=l-1=Upon completion of initial (self initiated) Machine State transition to the Startup state, Execution Management shall notify State Management that the Startup state of Machine State has been reached.  # Machine State Startup Completion
                      SWS_EM_02242: p=l-1=[Execution Management, Function Group State, Machine State]  # Further Function Group State Changes
                  chapter sec_3a_MSShutdown:  # Shutdown
                    p=l-1=Execution Management does not perform shutdown of the Operating System. Instead it is required that at least one Process provides a mechanism to shutdown the Operating System. This Process is expected to be configured to run inside Shutdown Machine State. See TPS_2d_ManifestSpecification constr_1618.
                    p=l-1=A request to Execution Management to change the current Machine State to Shutdown is handled the same as any other Function Group state change request. From the point of view of Execution Management all Function Group are independent and therefore changes to them, can be applied without any side effects. However, from the point of view of State Management, where knowledge of the dependencies between different Function Group exist this may not be true. AUTOSAR assumes that State Management will requests Machine State Shutdown when it's valid to do so; see SWS_2d_StateManagement for advice on how to orchestrate shutdown of the Machine.
                    p=l-1=As mentioned in Section sec_3a_MSStartup AUTOSAR assumes that State Management will be configured to run in Shutdown. State transition is not a trivial system change and it can fail for a number of reasons - in which case State Management should remain alive so you can report an error and wait for further instructions. Please note that very purpose of this state is to shutdown Machine (this includes State Management) in a clean manner. Unfortunately this means that at some point State Management will no longer be available to report errors and subsequent errors should be handled through implementation specific mechanisms.
                    trace SWS_EM_01024: category=SPECIFICATION_ITEM, p=l-1={tt=Execution Management, e=Shutdown, tt=Function Group, e="MachineState"}  # Machine State Shutdown
                  chapter sec_3a_MSRestart:  # Restart
                    p=l-1=Execution Management does not perform restart of the Operating System. To restart the system it is required that at least one Process provide a mechanism to restart the Operating System. This Process is expected to be be configured to run inside Restart Machine State. See TPS_2d_ManifestSpecification constr_1619.
                    p=l-1=From the point of view of Execution Management, the Restart state of a Function Group with name "MachineState" is very similar to a Shutdown state. For the reasons mentioned in Section sec_3a_MSShutdown, a state transition to Restart is handled the same as any other Function Group state transition; please see SWS_2d_StateManagement for advice on how to orchestrate restart of the Machine.
                    p=l-1=As mentioned in Section sec_3a_MSStartup AUTOSAR assumes that State Management will be configured to run in Restart. The reasons for doing so are the same as for Section sec_3a_MSShutdown.
                    trace SWS_EM_01025: category=SPECIFICATION_ITEM, p=l-1={tt=Execution Management, e=Restart, tt=Function Group, e="MachineState"}  # Machine State Restart
                sec_3a_EMFunctionGroupState:  # Function Group State
                  p=l-1=If there is a group of functionally coherent Application installed on the machine, it will be useful to have ability of controlling them together. For that very reason the concept of Function Group was introduced to AUTOSAR Adaptive Platform.
                  p=l-1=Each Function Group has its own set of Process and set of states called Function Group State. Each Function Group State defines which Process shall be started when State Management requests Function Group State activation from Execution Management. Please note that minimal size of a Function Group is one Process and maximum size is implementation limited.
                  p=l-1=The Function Group mechanism is very flexible and is intended as a tool used to start and stop Process of Application. System integrator can assign Process to a Function Group State and then request it by State Management. For details on state change management see Section sec_3a_StateTransition.
                  p=l-1=In general, Machine State (see Section sec_3a_MachineState) are used to control machine lifecycle (startup/shutdown/restart) and Process of platform level Application, while other Function Group State individually control Process which belong to groups of functionally coherent user level Application. Please note that this doesn't mean that all Process of platform level Application has to be controlled by Machine State.
                  p=l-1=Figure fig_3a_FunctionGroupStates shows an example of state change sequence where several Process reference Machine State and Function Group State of two additional Function Group FG1 and FG2. For simplicity, only the three static Process States Idle, Running, and Terminated are shown for each process.
                  list=[p=l-1={tt=Process, e=A, tt=Machine State, e=Startup, tt=Self-terminating Process}, p=l-1={tt=Process, e=B, tt=Machine State, e=Startup, e=Running, tt=Process, e=A, tt=Execution Dependency, xref=sub_3a_Execution_20_Dependency}, p=l-1={tt=Process, e=C, tt=Machine State, e=Running, tt=Machine State, e=Diagnostics, tt=State Management}, p=l-1={tt=Process, e=D, e=E, tt=Function Group State, e=FG1:Running, tt=Execution Dependency, tt=Execution Management}, p=l-1={tt=Process, e=F, e=FG2:Running, e=FG2:Fallback}]
                  p=l-1=System design and integration should ensure that enough resources are available on the machine at any time, i.e. the added resource consumption of all Process which reference simultaneously active states should be considered.
                  p=l-1=A proper system configuration requires that each Process references in its Execution Manifest one or more Function Group State (which can be Machine State) of the same Function Group.
                  p=l-1=Each Process is assigned to one or several startup configurations (StartupConfig), which each can define the startup behavior in one or several Function Group State (including Machine State). For details see TPS_2d_ManifestSpecification. By parsing this information from the Execution Manifest, Execution Management can determine which Processes need to be launched if a specific Function Group State is entered, and which startup parameters are valid.
                  p=l-1=Please note AUTOSAR doesn't support the possibility of assigning a single Process to more than one Function Group, see TPS_2d_ManifestSpecification (constr_1688).
                  p=l-1=Please note that SWS_EM_01110 and SWS_EM_01023 together define the very first Function Group state transition after the power up. When Execution Management starts it performs Machine State transition from the "Off" state (the default state) to the "Startup" state.
                  p=l-1=[Process, Execution Manifest, Function Group State, Machine State, TPS_2d_ManifestSpecification]
                  p=l-1=The arbitrary state change sequence as shown in Figure fig_3a_Sequence_Transition_to_Machine_State_StateXYZ applies to state changes of any Function Group - just replace "MachineState" by the name of the Function Group. On receipt of the state change request, Execution Management terminates no longer needed Process and then starts Process active in the new Function Group State before confirming the state change to State Management. For details see Section sec_3a_StateTransition.
                  figure caption fig_3a_FunctionGroupStates  # State dependent process control
                  6 x trace, all with category=SPECIFICATION_ITEM:
                    SWS_EM_01107: p=l-1=[Execution Management, Function Group, Machine Manifest, Function Group]  # Function Group configuration
                    SWS_EM_01013: p=l-1=[Execution Management, Process, Function Group State, Execution Manifest]  # Function Group State
                    SWS_EM_01033: p=l-1=To enable a Process to be launched in multiple Function Group State, Execution Management shall be able to configure the Process start-up on every Function Group State change based on information provided in the Execution Manifest.  # Process start-up configuration
                    SWS_EM_01109: p=l-1=In the event of a misconfigured system, Execution Management shall not start a Process that doesn't reference at least one state.  # Misconfigured Process - not assigned to a Function Group
                    SWS_EM_02254: p=l-1=In the event of a misconfigured system, Execution Management shall not start a Process that references states from more than one Function Group.  # Misconfigured Process - assigned to more than one Function Group
                    SWS_EM_01110: p=l-1=Each Function Group (including the Function Group "MachineState") has an Off State which shall be used by Execution Management as default Function Group State, if no other state was requested.  # Off States
                sec_3a_StateInteraction: p=l-1=Figure fig_3a_StateInteraction shows a simplified example for the interaction between different types of states, after State Management functional cluster has requested different Function Group State . One can see the state transitions of the Function Group and the Process and Execution States of one Process which references one state of this Function Group, ignoring possible delays and dependencies if several Process were involved.  # State Interaction
                  figure caption fig_3a_StateInteraction  # Interaction between states
                sec_3a_StateTransition:  # State Transition
                  p=l-1={tt=State Management, tt=Function Group State, tt=Machine State, xref=sec_3a_api_em_StateClient_class, tt=StateClient::SetState, tt=State Management, tt=Function Group State, tt=Machine State, tt=Function Group, e="MachineState"}
                  p=l-1=Before we specify how internals of a state transition works, let's consider an example configuration illustrated in figure Figure fig_3a_ExampleStateTransition. As we can see Execution Dependency that spans outside of a Function Group and moreover of a single Function Group State are forbidden. The dependency from Process B (inside Function Group FG_B) to Process A (inside Function Group FG_A) is forbidden, as it would introduce hidden dependencies between Function Group that are not visible to State Management. If system configuration requires this kind of dependencies, please see SWS_2d_StateManagement for advice on how to configure them. Dependencies outside of a single Function Group State definition are forbidden, as they would result in starting a Process that is not configured to run in the given State. For more information on Execution Dependency see chapter Section sub_3a_Execution_20_Dependency (SWS_EM_01001 and constr_1689).
                  p=l-1=From the above we can conclude that each Function Group is a separate entity and state transition of one Function Group doesn't have side effects on another Function Group. Please note that this is true from the point of view of Execution Management and may differ from the point of view of State Management (see SWS_2d_StateManagement if you need more information on this).
                  p=l-1=In the following requirements, the term "the Process references a State" means that a Process has in its Execution Manifest an aggregation of StateDependentStartupConfig in the role Process.Process.stateDependentStartupConfig with an instanceRef to a ModeDeclaration in the role StateDependentStartupConfig.StateDependentStartupConfig.functionGroupState that belongs to that State.
                  p=l-1={e=CurrentState, e=State, tt=Function Group, tt=Machine State, tt=Function Group, e="MachineState", tt=Function Group State, tt=Machine State}
                  p=l-1=[RequestedState, CurrentState]
                  p=l-1=In other words CurrentState is the starting point of the transition, the list of the Process that should be currently running inside the Function Group (please note the existence of Self-terminating Process). RequestedState is a destination point of the state transition, the list of the Process that will be running inside of the Function Group once the state transition finishes successfully (please note the existence of Self-terminating Process).
                  p=l-1={e=StartupConfig, tt=StateDependentStartupConfig, tt=Process, tt=Process.stateDependentStartupConfig, tt=Process}
                  p=l-1=State transition is a complicated process, however it is composed out of three simple logical steps:
                  list=[p=l-1=Terminate all Process that are currently running and are not needed in the RequestedState, p=l-1=Restart all Process that are currently running and have StartupConfig that differs between the CurrentState and the RequestedState, p=l-1=Start all Process that are not running currently and are needed in the RequestedState]
                  p=l-1=Please see Section sec_3a_ExecutionState and Section sec_3a_ProcessStates for more detail information on how Execution Management handles termination and start of Process (restart is a sequence of termination and start).
                  p=l-1=Please note that SWS_EM_02251 only request a termination of Process, the start part will fall under SWS_EM_01066 requirement thus making the restart complete.
                  p=l-1=[Execution Management, Process, Process, Machine Manifest, TPS_MANI_03151, Process, Execution Manifest, TPS_MANI_01278]
                  p=l-1=On multi-process POSIX platforms, this could be achieved using a SIGKILL signal.
                  p=l-1=Note that in SWS_EM_01065, SWS_EM_02255 and n SWS_EM_02258, Process termination timeout monitoring applies to all termination sequences including self-termination.
                  p=l-1=[Execution Management, Process, Process, Execution Manifest, TPS_MANI_01277]
                  p=l-1={tt=Execution Management, tt=Process, tt=Process, tt=Execution Manifest, tt=TPS_MANI_03149, tt=Non-reporting Process, tt=Non-reporting Process, tt=Process State, e=Idle, e=Running, e=Starting}
                  p=l-1=When starting new Process, Execution Management is obligated to perform dependency resolution. When doing so it may came across a configuration where Process B depends on Process A, but Process A needs to be restarted during state change. Please see Figure fig_3a_FunctionGroupStatesDependencies for more details.
                  p=l-1=Please note that SWS_EM_02245 doesn't bring new functionality to state transition. It merely ensures that SWS_EM_02251 and SWS_EM_01066 are performed on Process A, before SWS_EM_01066 is performed on Process B. If this order is not ensured then SWS_EM_02245 could not be satisfied as Process A will be a Process that is configured for CurrentState and not for RequestedState.
                  p=l-1=Description of Function Group State transition in this chapter may give impression that, it is required to first stop all Process that are not needed in RequestedState, before you can start any of the Process that are needed. Please note that this is not the case. Step by step approach of this chapter was chosen to introduce as much clarity as possible, when describing Function Group State transition. Implementers are free to parallelize as much steps (needed for state transition) as possible for a particular implementation.
                  p=l-1=If not protected StateClient can be used to destabilise Machine, see Section sec_3a_api_em_StateClient_class for more details.
                  figure caption fig_3a_ExampleStateTransition  # Example configuration for state transition
                  9 x trace, all with category=SPECIFICATION_ITEM:
                    SWS_EM_01060: p=l-1=On state transition Execution Management shall terminate all Process that references the CurrentState in its Execution Manifest, but don't references the RequestedState and have Process State different than \lbrackIdle or Terminated\rbrack.  # State transition - termination behavior
                    SWS_EM_02251: p=l-1=On state transition Execution Management shall terminate all Process that references the CurrentState in its Execution Manifest, but references the RequestedState with different StartupConfig and have Process State different than \lbrackIdle or Terminated\rbrack.  # State transition - restart behavior
                    SWS_EM_01065: p=l-1={tt=Execution Management, tt=Process, tt=Process, e=Terminated, tt=Process State}  # State transition - Process termination timeout monitoring
                    SWS_EM_02255: p=l-1=In case a Process termination timeout occurred, Execution Management shall request the Operating System to terminate the underlying process.  # State transition - Process termination timeout reaction
                    SWS_EM_02258: p=l-1=When the termination of a Process resulted in the timeout, Execution Management shall perform following actions:, list=item=p=l-1=Report error code back to State Management to indicate that the State change request cannot be fulfilled.  # State transition - Process termination timeout reporting
                    SWS_EM_01066: p=l-1=On state transition Execution Management shall start all Process that references the RequestedState in its Execution Manifest and have Process State that is \lbrackIdle or Terminated\rbrack.  # State transition - start behavior
                    SWS_EM_02253: p=l-1={tt=Execution Management, tt=Process, tt=Execution Management, tt=Process, e=Running, tt=Process State}  # State transition - Process start-up timeout monitoring
                    SWS_EM_02260: p=l-1=In case a Process start-up timeout occurred, Execution Management shall request Process termination. If Process doesn't terminate as requested, Execution Management shall request the Operating System to terminate the underlying process. After the process is terminated, the Process shall be restarted a numberOfRestartAttempts number of times until success or final fail.  # State transition - Process start-up timeout reaction
                    SWS_EM_02259: p=l-1=When the start-up of a Process resulted in the timeout, Execution Management shall perform following actions:, list=item=p=l-1=Report error code back to State Management to indicate that the State change request cannot be fulfilled.  # State transition - Process start-up timeout reporting
                  figure caption fig_3a_FunctionGroupStatesDependencies  # Dependency resolution during state change
                  trace SWS_EM_02245: category=SPECIFICATION_ITEM, p=l-1={tt=Execution Management, tt=Execution Dependency, tt=Process, e=RequestedState}  # Dependency resolution during state change
                  trace SWS_EM_01067: category=SPECIFICATION_ITEM, p=l-1=When all operation required for a state transition has been performed successfully, Execution Management shall consider the transition to be complete, set the CurrentState to the RequestedState and report success back to State Management.  # Finish of a successful state transition
                  trace SWS_EM_02297: category=SPECIFICATION_ITEM, p=l-1=[AdaptivePlatform, State Management, StateClient]  # StateClient usage restriction
            sect_3a_ApplicationRecoveryActions  # Application Recovery Actions
              chapter chap_3a_Oveiew__4a18a085: p=l-1=[Execution Management, Process, Process], p=l-1=The Platform Health Management monitors Process and could trigger a Recovery Action in case any Process behaves not within the specified parameters., p=l-1=The Recovery Action are defined by the integrator based on the software architecture requirements for the Platform Health Management and configured in the Execution Manifest.  # Overview
                figure caption fig_3a_ArchitectureViewRecoveryActions  # Adaptive Platform - Recovery Action Architecture
                trace SWS_EM_02257: category=SPECIFICATION_ITEM, p=l-1=The AdaptivePlatform implementation shall only allow Platform Health Management to use the Process State Information and RecoveryAction APIs.  # Recovery Action API Security
              chapter chap_3a_Proess_State_Infion__fd060709  # Process State Information
                chapter chap_3a_Get_Proess_States_Infion__a9d29b68  # Get Process States Information
                  trace SWS_EM_02076: category=SPECIFICATION_ITEM, p=l-1=[Execution Management, Platform Health Management, Process]  # Get Process States Information
                chapter chap_3a_Proess_State_Traion_Event__0bd07056  # Process State Transition Event
                  trace SWS_EM_02077: category=SPECIFICATION_ITEM, p=l-1=[Execution Management, Platform Health Management, Process]  # Process State Transition Event
              chapter chap_3a_Recery_Actons__024bde30  # Recovery Actions
                chapter chap_3a_Proess_Resar__800b9695: p=l-1=Remark: The Process Restart IFC API is a powerfull but also a critical API. The integrator should be sure about all consequences when using this API. Usually such an API could be used to restart the State Manager, all other scenarious might become complex.  # Process Restart
                  4 x trace, all with category=SPECIFICATION_ITEM:
                    SWS_EM_01016: p=l-1=[Execution Management, Process, Platform Health Management]  # Process Restart
                    SWS_EM_01062: p=l-1=[Execution Management, Process, Platform Health Management]  # Process Restart Behavior
                    SWS_EM_01063: p=l-1=[Execution Management, Process, Process]  # Process Restart Failed
                    SWS_EM_01064: p=l-1=When Execution Management succeeds with restarting the Process, a success code shall be returned to the requester of the Process restart.  # Process Restart Successful
                chapter chap_3a_Enter_Unrble_State__d292ee87:  # Enter Unrecoverable State
                  p=l-1=The implementation of an Enter Unrecoverable State request could trigger the following actions:
                  list=[p=l-1=call a "pre-cleanup action" to inform others about the switch to the Unrecoverable State, p=l-1=shutdown all processes, p=l-1=call a "post-cleanup action" to set the machine in a physically known state, the machine will NOT return from this State. However as explained in the limitation above this is an example and NOT prescriptive.]
                  p=l-1=Examples: pre-cleanup action (optional):
                  list=item={p=l-1=information another machine about the status, list=[p=l-1=for error reporting to the driver via the cluster display (Level 1,2), p=l-1=to activate a backup functionality (Level 4,5)]}
                  p=l-1=post-cleanup action (mandatory):
                  list=[p=l-1=to set the machine in a physically known state (switch the HW in a safe and stable state), p=l-1=the Adaptive Application machine will NOT return from this State]
                  trace SWS_EM_02261: category=SPECIFICATION_ITEM, p=l-1=[Execution Management, Execution Management, Platform Health Management]  # Enter Unrecoverable State
                  trace SWS_EM_02262: category=SPECIFICATION_ITEM, p=l-1=The Machine will never return from this Unrecoverable State.  # Enter Unrecoverable State Behavior
            sec_3a_DetExecFull  # Deterministic Execution
              chapter sec_3a_IntroductionDetExec:  # Determinism
                p=l-1=In real-time systems, deterministic execution often means, that a calculation of a given set of input data always produces a consistent output within a bounded time, i.e. the behavior is reproducible.
                p=l-1=In the context of Execution Management, the term ``calculation'' can apply to execution of a thread, a Process, or a group of Process. The calculation can be event-driven or cyclic; i.e. time-driven.
                p=l-1=It is also worthwhile to note that determinism must be distinguished from other non-functional qualities like reliability or availability, which all deal in different ways with the statistical risk of failures. Determinism does not provide such numbers, it only defines the behavior in the absence of errors.
                p=l-1=There are multiple elements in determinism and here we distinguish them as follows:
                list=[p=l-1=Time Determinism: The output of the calculation is always produced before a given deadline (a point in time)., p=l-1=Data Determinism: Given the same input and internal state, the calculation always produces the same output., p=l-1=Full Determinism: Combination of Time and Data Determinism as defined above.]
                p=l-1=In particular, deterministic behavior is important for safety-critical systems, which may not be allowed to deviate from the specified behavior at all. Whether Time Determinism, or in addition Data Determinism is necessary to provide the required functionality depends on the system and on the safety goals.
                p=l-1=Expected use cases of the AUTOSAR Adaptive Platform where such determinism is required include:
                list=[p=l-1=Software Lockstep: To execute ASIL C/D applications with high computing performance demands, specific measures, such as software lockstep are required, due to high transient hardware error rates of high performance microprocessors. Software lockstep is a technique where the calculation is done redundantly through two different execution paths and the results are compared. To make the redundant calculations comparable, software lockstep requires a fully deterministic calculation. For details see sec_3a_RedundantDetExec., p=l-1=Reuse of verified software: The deterministic subsystem shows the same behavior on different platforms which satisfy the performance and resource needs of the subsystem, regardless of other differences in each environment, such as existence of unrelated applications. Examples include the different development and simulation platforms. Due to reproducible functional behavior, many results of testing, configuration and calibration of the subsystem are valid in each environment where the subsystem is deployed on and don't need to be repeated.]
                chapter sec_3a_IntroductionDetTime:  # Time Determinism
                  p=l-1=Each time a calculation is started, its results are guaranteed to be available before a specified deadline. To achieve this, sufficient and guaranteed computing resources (processor time, memory, service response times etc.) should be assigned to the software entities that perform the calculation. For more information on resources see chapter sect_3a_Resources.
                  p=l-1=Non-deterministic ``best-effort'' Process can request guaranteed minimum resources for basic functionality, and additionally can have maximum resources specified for monitoring purposes. However, if Time Determinism is requested, the resources must be guaranteed at any time, i.e. minimum and maximum resources are identical.
                  p=l-1=If the assumptions for deterministic execution are violated, e.g. due to a deadline miss, this must be treated as an error and recovery actions must be initiated. In non-deterministic ``best-effort'' subsystems such deadline violations or other deviations from normal behavior sometimes can be tolerated and mitigated without dedicated error management.
                  p=l-1=Fully-Deterministic behavior additionally requires Data Determinism, however in many cases Time Determinism is sufficient.
                chapter sec_3a_IntroductionDetData:  # Data Determinism
                  p=l-1=For Data Determinism, each time a calculation is started, its results only depend on the input data. For a specific sequence of input data, the results always need to be exactly the same, assuming the same initial internal state.
                  p=l-1=A common approach to verify Data Determinism in a safety context is the use of lockstep mechanisms, where execution is done simultaneously through two different paths and the result is compared to verify consistency. Hardware lockstep means that the hardware has specific equipment to make this double-/multi-execution transparent. Software lockstep is another technique that allows providing a similar property without requiring the use of dedicated hardware.
                  p=l-1=Depending on the Safety Level, as well as the Safety Concept employed, software lockstep may involve executing multiple times the same software, in parallel or sequentially, but may also involve running multiple separate implementations of the same algorithm.
                chapter sec_3a_IntroductionDetFull:  # Full Determinism
                  p=l-1=For Full Determinism, each time a calculation is started, its results are available before a specified deadline and only depend on the input data, i.e. both Time and Data Determinism must be guaranteed.
                  p=l-1=Currently, only Full Deterministic behavior of one Process is supported. Determinism of a cluster of Process on one or even several machines needs extensions of the Communication Management, which have not been specified yet.
                  p=l-1=Non-deterministic behavior may arise from different reasons; for example insufficient computing resources, or uncoordinated access of data, potentially by multiple threads running on multiple processor cores. The order in which the threads access such data will affect the result, which makes it non-deterministic (``race condition'').
                  p=l-1=A fully deterministic calculation must be designed, implemented and integrated in a way such that it is independent of processor load caused by other functions and calculations, sporadic unrelated events, race conditions, deviating random numbers etc., i.e. for the same input and initial conditions it always produces the same result within a given time.
              chapter sec_3a_RedundantDetExec:  # Redundant Deterministic Execution
                p=l-1=As explained in sec_3a_IntroductionDetExec, future systems need high computing performance in combination with high ASIL safety goals. In this chapter we specify mechanisms which support deterministic multithread execution to support high performance software lockstep solutions. Here are some additional rationales behind it:
                list=[p=l-1=Safety goals for Highly Automated Driving (HAD) systems can be up to ASIL D., p=l-1=High Performance Computing (HPC) demands can only be met by non automotive-grade, e.g. consumer electronics (CE), microprocessors, which have high transient hardware error rates compared to automotive-grade microcontrollers. Most likely no such microprocessor is available for ASIL above B, at least for the parts relevant to the design., p=l-1=To deal with high error rates, ASIL C/D HAD applications require specific measures, in particular software lockstep, where execution is done redundantly through two different paths and the result is compared to detect errors., p=l-1=To make these redundant calculations comparable, software lockstep requires a fully deterministic calculation as defined in sec_3a_IntroductionDetFull., p=l-1=To meet HPC demands, highly predictable and reliable multi-threading must be supported]
                p=l-1=Figure fig_3a_DetExLockstep shows a simplified example for a possible software lockstep architecture.
                p=l-1=Two redundant Process, which run in an internal cycle, get in each cycle the same input data via regular interfaces of Communication Management and produce (in the absence of errors) the same results, due to full deterministic execution.
                p=l-1=[Execution Management, DeterministicClient, DeterministicClient, Process, DeterministicClient, Communication Management]
                p=l-1=For each execution cycle, the software lockstep framework synchronizes input data in cooperation with Communication Management, makes sure that random numbers and activation time stamps are identical for the redundantly executed Process, synchronizes triggering of execution, and compares the output to detect failures (e.g. transient processor core or memory errors due to radiation) in one of the redundant Process. This infrastructure layer can span over multiple hardware instances and is implementation specific.
                p=l-1=Details of the software lockstep framework are out of scope of the Adaptive Platform specification. The interaction with DeterministicClient and Communication Management depends on hardware architecture and specific platform design and is a USP of platform providers; so this can only be partly specified in later releases.
                p=l-1=In case of restart of one of the Process as an error recovery action due to errors detected when comparing the results, the internal states (i.e. internal memory) need to be resynchronized. To do so, both redundant Process might need to be re-initialized or even restarted. Figure fig_3a_DeterministicExecution zooms into one of the redundantly executed Process.
                p=l-1=The AUTOSAR Adaptive Platform needs to provide some library functions to support redundant deterministic execution with sufficient isolation. The library functions (DeterministicClient) run in the context of the user Process.
                p=l-1=Cyclic Process behavior is controlled by a wait point API. The API returns a code to control the process mode (register services/ service discovery/ init/ run/ terminate). The execution is triggered by the DeterministicClient, depending on a defined period or on received events. Within a Process, all input data is available via ara::com (polling-based access only) when execution starts and is stable over one execution cycle. For details see sec_3a_DetExeCyclicExe.
                p=l-1=The workload can be deployed to a worker pool API, which allows deterministic execution of a set of container elements (e.g. data sets), which are processed in parallel by the same runnable object (i.e. application function). The runnable object is not allowed to exchange any information while it is running, i.e. it doesn't access data which can be altered by other instances of the runnable object to avoid race conditions. The runnable object instances can physically run in parallel or sequentially in any order. For details see sec_3a_DetExeWorkerPool.
                p=l-1=Additional DeterministicClient APIs provide random numbers and activiation time stamps. Common HAD algorithms use particle filters which require random numbers. If used from within the worker pool, the random numbers are assigned to specific container elements to allow deterministic redundant execution. The activation time stamps don't change until the Process reaches its next wait point. For deterministic redundant execution, random number seeds and time stamps need to be synchronized. For details see sec_3a_DetExeRandom and sec_3a_DetExeTimeStamps.
                p=l-1=At the end of the execution cycle, the Process returns to the wait point and waits for the next activation.
                p=l-1=The APIs of DeterministicClient are standardized and provide abstraction of the application deployment on the actual hardware. The implementation is vendor specific and needs to be configured at integration time individually for each Process which uses it.
                p=l-1=The DeterministicClient Class is only local to the Process. Therefore, there is currently no security concern foreseen for this API.
                p=l-1=Different variants of the DeterministicClient might work in a software lockstep environment or stand-alone, to support cyclic execution and deterministic worker pools.
                figure caption fig_3a_DetExLockstep  # Software Lockstep in a typical data flow processing
                figure caption fig_3a_DeterministicExecution  # Cyclic Deterministic Execution
                figure caption fig_3a_ArchitectureView_2d_DeterministicClient  # Deterministic Execution Interface
              chapter sec_3a_DetExeCyclicDetExe: p=l-1=This section describes the APIs shown in Figure fig_3a_DeterministicExecution, and how they need to be used by a Process to execute deterministically, so the Process can be transparently integrated into a software lockstep environment.  # Cyclic Deterministic Execution
                5 x chapter:
                  sec_3a_DetExeCyclicExe:  # Control of Cyclic Execution
                    p=l-1=[Execution Management, Process]
                    p=l-1=After the Process has been started by Execution Management, it reports ExecutionState ExecutionState.kRunning (see sec_3a_ExecutionState) and calls DeterministicClient::WaitForNextActivation.
                    p=l-1=The Process executes one cycle when DeterministicClient::WaitForNextActivation returns and then calls the API again to wait for the next activation.
                    p=l-1=A return value controls the internal lifecycle (e.g. init, run, terminate) of the Process, see Figure fig_3a_DeterministicExecution. The return codes are used to synchronize the behavior of two Process in case they are executed redundantly.
                    p=l-1=The Process returns to DeterministicClient::WaitForNextActivation after each of the following sequential steps:
                    labeled-list=[{item-label=l-2=Register Services, p=l-1=-- The Process registers its communication services, i.e. the services it offers via Communication Management. This should be the only occasion for performing service registering. No other functionality should be performed in this step to limit resource consumption and runtime, so no dedicated budget needs to be assigned.}, {item-label=l-2=Service Discovery, p=l-1=-- The Process does communication service discovery. This should be the only occasion for performing service discovery, except a service needs to be replaced later (see (SWS_EM_01304). No other functionality should be performed in this step to limit resource consumption and runtime, so no dedicated budget needs to be assigned.}, {item-label=l-2=Init, p=l-1=-- The Process initializes its internal data structures. The worker pool (see sec_3a_DetExeWorkerPool) can be accessed once or several time sequentially. A budget (see sec_3a_DetExeResources) needs to be assigned to the ``Init'' cycle.}, {item-label=l-2=Run, p=l-1=-- The Process performs one cycle of its normal cyclic execution. This can be repeated indefinitely. The worker pool (see sec_3a_DetExeWorkerPool) can be accessed once or several times sequentially within a cycle. A budget (see sec_3a_DetExeResources) needs to be assigned.}, {item-label=l-2=Terminate, p=l-1=-- The Process prepares to terminate. The actual termination is performed according to SWS_EM_01404 or SWS_EM_01405, see section sec_3a_ProcessStates.}]
                    p=l-1=The service discovery update needs to be triggered by Communication Management in an implementation specific way. Because the service discovery update runs in addition to the kRun execution within a kRun cycle, the worst case execution time estimation and budget assignment need to consider that kRun and kServiceDiscovery might run sequentially within the configured execution cycle time (see below).
                    p=l-1=The point in time when DeterministicClient::WaitForNextActivation returns with kRegisterServices, kServiceDiscovery, kInit, kRun (first kRun cycle only, otherwise see below) or kTerminate is implementation specific. In case of redundant execution, the sequences need to be synchronized.
                    p=l-1=The activation behavior of the kRun-cycles can be realized by Execution Management together with the Communication Management as required by the safety concept. Execution can be triggered via two distinct mechanisms.
                    list=[p=l-1=Periodic activation means that DeterministicClient::WaitForNextActivation returns periodically based on a defined period., p=l-1=Event-triggered activation means that DeterministicClient::WaitForNextActivation returns based on the communication-event-triggers that are configured for the Process from the outside via Communication Management, e.g. by external units, events generated due to the arrival of data or timer events. Details are out of scope of the Adaptive Platform specification.]
                    p=l-1=This cyclic behavior can be used in a software lockstep environment to initialize and trigger execution of redundant Process and compare the results after a cycle has finished. For redundant execution, the execution behavior and its budget (activation timing, computing time, computing resources) should be explicitly visible at integration time to configure Execution Management accordingly.
                    p=l-1=[Execution Management, Communication Management, Communication Management]
                    7 x trace, all with category=SPECIFICATION_ITEM:
                      SWS_EM_01301: p=l-1=[Execution Management, DeterministicClient::WaitForNextActivation]  # Cyclic Execution
                      SWS_EM_01302: p=l-1=[DeterministicClient::WaitForNextActivation, Process]  # Cyclic Execution Control
                      SWS_EM_01303: p=l-1=The return code of DeterministicClient::WaitForNextActivation shall follow this sequence: kRegisterServices, kServiceDiscovery, kInit, kRun, and kTerminate. Only the code kRun can be returned repeatedly, i.e. more than once.  # Cyclic Execution Control Sequence
                      SWS_EM_01304: p=l-1=In case a service which is accessed by the Process needs to be replaced (e.g. due to unavailability) while the kRun cycles are executed, DeterministicClient::WaitForNextActivation shall return kServiceDiscovery once immediately after DeterministicClient::WaitForNextActivation is called, and then continue with the normal kRun cycle.  # Service Modification
                      SWS_EM_01351: p=l-1=[DeterministicClient::WaitForNextActivation, DeterministicClient]  # Execution Cycle Time
                      SWS_EM_01352: p=l-1=If the Process calls DeterministicClient::WaitForNextActivation within a kRun cycle after the configured cycle time ``cycleTimeValue'' has been exceeded since the last activation, Platform Health Management shall be notified about the timeout to initiate appropriate recovery actions.  # Execution Cycle Timeout
                      SWS_EM_01353: p=l-1=If the configured cycle time ``cycleTimeValue'' is zero, DeterministicClient::WaitForNextActivation shall be triggered by Communication Management to start the next kRun cycle. The trigger conditions are implementation specific and evaluated by Communication Management.  # Event-triggered Cycle Activation
                  sec_3a_DetExeWorkerPool:  # Worker Pool
                    p=l-1=The worker pool is triggered by the main-thread of the Process in a sequential order. DeterministicClient::RunWorkerPool is blocking and therefore there is no parallelism between the main-thread and the worker pool. The user Process is not allowed to create threads on its own by using normal POSIX mechanisms to avoid the risk of inducing indeterministic behavior.
                    p=l-1={tt=DeterministicClient::RunWorkerPool, xref=fig_3a_WorkerPool}
                    p=l-1=The implementation and size of the worker pool (i.e. number of threads) is hidden from the user. The Integrator decides about the size and the implementation and configures a parameter ``numberOfWorkers'' (see DeterministicClient). The distribution of the worker threads to processor cores is left to the Operating System.
                    p=l-1=If the number of required container elements exceeds the number of workers (threads) in the deterministic worker pool, Execution Management can use the worker pool several times sequentially (with unrestricted interleaving), which shall be transparent to the user of the worker pool. To achieve Data Determinism, the parallel workers need to satisfy certain implementation properties, e.g. no exchange of data is allowed between the instances of the runnable object which are processed by the workers. For details see EXP_2d_AdaptivePlatformInterfacesGuidelines. Other, more complex solutions which allow interaction between the workers would be possible, but they increase complexity, reduce utilization and transparency, and are error-prone regarding the deterministic behavior.
                    p=l-1=The worker pool runs within the Process context of the caller of this API. It is designed as part of Execution Management to guarantee the deterministic behavior by incorporating it in the DeterministicClient::WaitForNextActivation cycle.
                    p=l-1=An example for the implementation of a worker runnable object can be found in EXP_2d_AdaptivePlatformInterfacesGuidelines.
                    p=l-1=The aim is to abstract the data processing as far as possible, irrespective of the actual number of available parallel execution paths. Example: a task with N similar subtasks (e.g. N Kalman-filters). The task is assigned to the worker pool and the worker pool processes it using a given worker runnable object (in this example the worker runnable object would be the Kalman-filter).
                    p=l-1=The worker pool cannot be used to process multiple different tasks in parallel. The use of multiple potentially different explicit functions (worker runnable objects) could add unnecessary complexity and can lead to extremely heterogeneous runtime utilization, as each worker may have different computing time. This would complicate the planning of resource deployment, which is necessary for black-box integration.
                    trace SWS_EM_01305: category=SPECIFICATION_ITEM, p=l-1=[Execution Management, DeterministicClient::RunWorkerPool, Process]  # Worker Pool
                    trace SWS_EM_01306: category=SPECIFICATION_ITEM, p=l-1=tt=DeterministicClient::RunWorkerPool  # Processing Container Objects
                    figure caption fig_3a_WorkerPool  # Worker Pool Usage
                  sec_3a_DetExeRandom:  # Random Numbers
                    p=l-1=If used from within DeterministicClient::RunWorkerPool, the random numbers are assigned to specific container elements, using the container iterator, to allow deterministic redundant execution.
                    p=l-1=The provision of the seeds for the pseudo random numbers generation is designed as part of Execution Management to guarantee the deterministic behavior by incorporating it in the DeterministicClient::WaitForNextActivation cycle.
                    p=l-1=Implementations of DeterministicClient which do not need to support redundant execution can provide standard random numbers without specific properties.
                    trace SWS_EM_01308: category=SPECIFICATION_ITEM, p=l-1={tt=Execution Management, tt=DeterministicClient::GetRandom, tt=Process, trace=SWS_EM_01305}  # Random Numbers
                  sec_3a_DetExeTimeStamps: p=l-1=The deterministic user Process might need timing information while cyclically (see sec_3a_DetExeCyclicExe) processing its input data in the kRun cycle. The used time value may have an influence on the calculated results. Therefore, Execution Management returns deterministic timestamps that represent the points in time when the current cycle was activated and when the next cycle will be activated, if this value is known. The timestamps are required to be identical for Process which are executed redundantly, e.g. in a lockstep environment (see sec_3a_RedundantDetExec).  # Time Stamps
                    4 x trace, all with category=SPECIFICATION_ITEM:
                      SWS_EM_01310: p=l-1={tt=Execution Management, tt=DeterministicClient::GetActivationTime, tt=DeterministicClient::WaitForNextActivation, trace=SWS_EM_01301, tt=Process}  # Get Activation Time
                      SWS_EM_01311: p=l-1=If DeterministicClient::GetActivationTime is called from outside a kRun cycle, Execution Management shall return kNotAvailable.  # Activation Time Unknown
                      SWS_EM_01312: p=l-1={tt=Execution Management, tt=DeterministicClient::GetNextActivationTime, tt=DeterministicClient::WaitForNextActivation, trace=SWS_EM_01301, tt=Process}  # Get Next Activation Time
                      SWS_EM_01313: p=l-1=In case the next activation time is not known when calling DeterministicClient::GetNextActivationTime, e.g. because of non-equidistant event-triggered activation, Execution Management shall return kNotAvailable.  # Next Activation Time Unknown
                  sec_3a_DetExeResources:  # Real-Time Resources
                    p=l-1=To ensure Time Determinism (see sec_3a_IntroductionDetTime), i.e. to make sure that a cyclic deterministic execution within a Process (see sec_3a_DetExeCyclicExe) is finished at a given deadline we need:
                    list=[p=l-1={tt=Execution Management, xref=sec_3a_DetExeWorkerPool}, p=l-1=The integrator needs to assign appropriate resources to the Process., p=l-1=The integrator needs to assign appropriate scheduling policies. Details and options other than standard POSIX scheduling policies (see SWS_EM_01014) heavily depend on the used Operating System, are vendor specific, and are for now out of scope of the Adaptive Platform specification., p=l-1=The integrator needs to configure deadline monitoring, possibly execution budget monitoring, and appropriate recovery actions in case of violations. For more details on resources see sect_3a_Resources.]
                    p=l-1=To make sure that all Process which use the DeterministicClient APIs get enough computing resources and can finish their cycle in time, it is in particular important to know when the worker pool (DeterministicClient::RunWorkerPool) is needed within a kInit and kRun DeterministicClient::WaitForNextActivation cycle. Also, a good computing resource utilization can only be achieved if usage of the workers (i.e. of available cores) can be distributed evenly over time. If the application code is known to the integrator, it should not be a problem to analyze the behavior and configure the system accordingly. However, if third party ``black box'' applications are delivered for integration, their resource demands need to be described in a standardized way, so the integrator has a rough idea about the distribution of resource consumption within a DeterministicClient::WaitForNextActivation-cycle.
                    p=l-1=To describe budget needs within the kInit and kRun cycle, we use a normalized value NormalizedInstruction to specifiy runtime consumption on the target system.
                    p=l-1=tt=NormalizedInstruction
                    p=l-1=tt=NormalizedInstruction
                    p=l-1=The following parameters (DeterministicClientResource, see TPS_MANI_01200 in TPS_2d_ManifestSpecification) are relevant for describing the computing time budget needs of a Process which uses DeterministicClient::RunWorkerPool.
                    p=l-1=The parameters are needed to be specified twice per Process which uses DeterministicClient, once for the kInit cycle and once for the kRun cycles (DeterministicClientResourceNeeds, and TPS_MANI_01199).
                    list=[p=l-1=e=numberOfInstructions, p=l-1={e=speedup, e=numberOfWorkers, xref=sec_3a_DetExeWorkerPool}, p=l-1=e=sequentialInstructionsBegin, p=l-1=e=sequentialInstructionsEnd]
                    topic 1 topic_3a_Exales__03c83b70  # Examples
                      note p=l-1=The Process uses the worker pool mainly in the middle of the cycle. The first 100 (normalized) instructions are mostly sequential, the next 275 instructions have a benefit when using the worker pool, and the last 125 instructions are mostly sequential again. The average speedup, over the complete 500 instructions is 1.3., list=[p=l-1=e=numberOfInstructions, p=l-1=e=numberOfWorkers, p=l-1=e=speedup, p=l-1=e=sequentialInstructionsBegin, p=l-1=e=sequentialInstructionsEnd]:
                        l-1:
                          xref target Worker_20_Pool_20_at_20_Beginning_20_of_20_Cycle
                        figure caption fig_3a_WorkerPoolResources01  # Worker pool used in middle of cycle
                      note p=l-1=The Process runs sequentially throughout most of the cycle and does not benefit in using the worker pool, i.e. the overhead of using the worker pool compensates the parallelization gain., list=[p=l-1=e=numberOfInstructions, p=l-1=e=numberOfWorkers, p=l-1=e=speedup, p=l-1=e=sequentialInstructionsBegin, p=l-1=e=sequentialInstructionsEnd]:
                        l-1:
                          xref target Sequential_20_Process
                        figure caption fig_3a_WorkerPoolResources02  # No benefit from worker pool
                      note p=l-1=The Process fully utilizes the worker pool throughout the cycle., list=[p=l-1=e=numberOfInstructions, p=l-1=e=numberOfWorkers, p=l-1=e=speedup, p=l-1=e=sequentialInstructionsBegin, p=l-1=e=sequentialInstructionsEnd]:
                        l-1:
                          xref target Full_20_Utilization_20_of_20_Worker_20_Pool
                        figure caption fig_3a_WorkerPoolResources03  # Full utilization of worker pool
            sect_3a_Resources:  # Resource Limitation
              p=l-1=Despite the correct behavior of a particular Adaptive Application in the system, it is important to ensure any potentially incorrect behavior, as well as any unforeseen interactions cannot cause interference in unrelated parts of the system RS_EM_00002. As AUTOSAR Adaptive Platform also strives to allow consolidation of several functions on the same machine, ensuring Freedom From Interference is a key property to maintain.
              p=l-1=However, AUTOSAR Adaptive Platform cannot support all mechanisms as described in this overview chapter in a standardized way, because the availability highly depends on the used Operating System.
              p=l-1=In addition, it is important to consider that Execution Management is only responsible for the correct configuration of the Machine. However, enforcing the associated restrictions is usually done by either the Operating System or another Application like the Persistency service.
              p=l-1=Some mechanisms that could be standardized will not yet be defined in this release.
              chapter sec_3a_IntroductionResConfig:  # Resource Configuration
                p=l-1=This section provides an overview on resource assignment to Process. The resources considered in this specification are:
                list=[p=l-1=RAM (e.g. for code, data, thread stacks, heap), p=l-1=CPU time]
                p=l-1=Other resources like persistent storage or I/O usage are also relevant, but are currently out of scope for this specification.
                p=l-1=In general, we need to distinguish between two resource demand values:
                list=[p=l-1=Minimum resources, which need to be guaranteed so the process can reach its Running state and perform its basic functionality., p=l-1=Maximum resources, which might be temporarily needed and shall not be exceeded at any time, otherwise an error can be assumed.]
                p=l-1=The following stakeholders are involved in resource management:
                list=[{p=l-1=Application Developer The Application developer should know how much memory (RAM) and computing resources the Process need to perform their tasks within a specific time. This needs to be specified in the Application description (which can be the pre-integration stage of the Execution Manifest) which is handed over to the integrator. Additional constraints like a deadline for finishing a specific task, e.g. cycle time, will usually also be configured here. However, the exact requirements may depend on the specific use case, e.g., list=[p=l-1=The RAM consumption might depend on the intended use, e.g. a video filter might be configurable for different video resolutions, so the resource needs might vary within a range., p=l-1=The computing power required depends on the processor type. i.e. the resource demands need to be converted into a computing time on that specific hardware. Possible parallel thread execution on different cores also needs to be considered here.], p=l-1=Therefore, while the Application developer should be able to bring estimates regarding the resource consumption, a precise usage cannot be provided out of context.}, {p=l-1=Integrator The integrator knows the specific platform and its available resources and constraints, as well as other applications which may run at the same time as the Process to be configured. The integrator should assign available resources to the applications which can be active at the same time, which is closely related to State Management configuration, see section sect_3a_EMMachineStateManagement. If not enough resources are available at any given time to fulfill the maximum resource needs of all running Process, assuming they are actually used by the Process, several steps have to be considered:, list=[p=l-1=Assignment of resource criticality to Process, depending on safety and functional requirements., p=l-1=Depending on the Operating System, maximum resources which cannot be exceeded by design (e.g. Linux cgroups) can be assigned to a process or a group of Process., p=l-1=A scheduling policy has to be applied, so threads of Process with high criticality get guaranteed computing time and finish before a given deadline, while threads of less critical Process might not. For details see section sec_3a_ResCpuUsage., p=l-1=If the summarized maximum RAM needs of all Process, which can be running in parallel at any given time, exceeds the available RAM, this cannot be solved easily by prioritization, since memory assignment to low critical Process cannot just be removed without compromising the Process. However, it should be ensured that Process with high criticality have ready access to their maximum resources at any time, while lower criticality Process need to share the remaining resources. For details see sec_3a_ResMemory.]}]
                p=l-1=Based on the above, all the resource configuration elements are to be configured during platform integration, most probably by the Integrator. To group these configuration elements, we define a ResourceGroup. It may have several properties configured to enable restricting Application running in the group. Subsequently, each Process is required to belong to a ResourceGroup, clarifying how the Application will be constrained at the system level.
                p=l-1=If a ResourceGroup does not have a configured RAM limit, then the Process are only bound by their implicit memory limit.
                p=l-1=If ResourceGroup does not have a configured CPU usage limit, then the Process are only bound by their implicit CPU usage limit (priority, scheduling scheme...).
                trace SWS_EM_02102: category=SPECIFICATION_ITEM, p=l-1=[Execution Management, Process, ResourceGroup, Process, ResourceGroup]  # Memory control
                trace SWS_EM_02103: category=SPECIFICATION_ITEM, p=l-1=[Execution Management, Process, ResourceGroup, Process, ResourceGroup]  # CPU usage control
              chapter sec_3a_IntroductionResMonit:  # Resource Monitoring
                p=l-1=As far as technically possible, the resources which are actually used by a Process should be controlled at any given time. For the entire system, the monitoring part of this activity is fulfilled by the Operating System. For details on CPU time monitoring see sec_3a_ResCpuUsage. For RAM monitoring see sec_3a_ResMemory. The monitoring capabilities depend on the used Operating System. Depending on system requirements and safety goals, an appropriate Operating System has to be chosen and configured accordingly, in combination with other monitoring mechanisms (e.g. for execution deadlines) which are provided by Platform Health Management.
                p=l-1=Resource monitoring can serve several purposes, e.g.
                list=[p=l-1=Detection of misbehavior of the monitored Process to initiate appropriate recovery actions, like Process restart or state change, to maintain the provided functionality and guarantee functional safety., p=l-1=Protection of other parts of the system by isolating the erroneous Process from unaffected ones to avoid resource shortage.]
                p=l-1=For Process which are attempting to exceed their configured maximum resource needs (see sec_3a_IntroductionResConfig), one of the following alternatives is valid:
                list=[p=l-1=The resource limit violation or deadline miss is considered a failure and recovery actions may need to be initiated. Therefore the specific violation gets reported to the Platform Health Management, which then starts recovery actions which have been configured beforehand. This will be the standard option for deterministic subsystems (see sec_3a_IntroductionDetExec)., p=l-1=For Process without hard deadlines, resource violations sometimes can be mitigated without dedicated error recovery actions, e.g. by interrupting execution and continue at a later point in time., p=l-1=If the OS provides a way to limit resource consumption of a Process or a group of Process by design, explicit external monitoring is usually not necessary and often not even possible. Instead, the limitation mechanisms make sure that resource availability for other parts of the system is not affected by failures within the enclosed Process. When such by-design limitation is used, monitoring mechanisms may still be used for the benefit of the platform, but are not required. Self-monitoring and out-of-process monitoring is currently out-of-scope in AUTOSAR Adaptive Platform.]
              chapter sec_3a_ResourceConfig: p=l-1=We need to be able to configure minimum, guaranteed resources (RAM, computing time) and maximum resources. In case Time or Full Determinism is required, the maximum resource needs are guaranteed.  # Application-level Resource configuration
                5 x chapter:
                  sec_3a_ResCpuUsage: p=l-1=CPU usage is represented in a Process by its threads. Generally speaking, Operating Systems use some properties of each thread's configuration to determine when to run it, and additionally constrain a group of threads to not use more than a defined amount of CPU time. Because threads may be created at runtime, only the first thread can be configured by Execution Management.  # CPU Usage
                  sec_3a_CoreAffinity: p=l-1=Requirement SWS_EM_02104 permits the initial thread (the ``main'' thread of the Process) to be bound to certain cores SWS_OSI_01012. Depending on the capabilities of the Operating System the sub-set could be a single core. If the Operating System does not support binding to specific cores then the only supported sub-set is the entire set of cores.  # Core Affinity
                    trace SWS_EM_02104: category=SPECIFICATION_ITEM, p=l-1=[Execution Management, Process]  # Core affinity
                  chap_3a_Sching__e3cef3e6:  # Scheduling
                    p=l-1=Currently available POSIX-compliant Operating Systems offer the scheduling policies required by POSIX, and in most cases additional, but different and incompatible scheduling strategies. This means for now, the required scheduling properties need to be configured individually, depending on the chosen OS.
                    p=l-1=Moreover, scheduling strategy is defined per thread and the POSIX standard allows for modifying the scheduling policy at runtime for a given thread, using pthread_setschedparam(). It is therefore not currently possible for the AUTOSAR Adaptive Platform to enforce a particular scheduling strategy for an entire Process, but only for its first thread.
                    p=l-1=For the detailed definitions of these policies, refer to IEEE1003_2e_1_2d_2016. Note, SCHED_OTHER shall be treated as non real-time scheduling policy, and actual behavior of the policy is implementation specific. It should not be assumed that the scheduling behavior is compatible between different AUTOSAR Adaptive Platform implementations, except that it is a non real-time scheduling policy in a given implementation.
                    p=l-1=While scheduling policies are not a sufficient method to guarantee Full Determinism, they contribute to improve it. While the aim is to limit CPU time for a Process, scheduling policies apply to threads.
                    p=l-1=Note that while Execution Management will ensure the proper configuration for the first thread (that calls the main() function), it is the responsibility of the Process itself to properly configure secondary threads.
                    p=l-1=The available priority range and actual meaning of the scheduling priority depends on the selected scheduling policy, see constr_1692, TPS_MANI_01061 and TPS_MANI_01188 in TPS_2d_ManifestSpecification.
                    trace SWS_EM_01014: category=SPECIFICATION_ITEM, p=l-1=[Execution Management, Process, Execution Manifest]  # Scheduling policy
                    item:
                      trace SWS_EM_01041: category=SPECIFICATION_ITEM, p=l-1={tt=Execution Management, e=SCHED_FIFO}  # Scheduling FIFO
                    item:
                      trace SWS_EM_01042: category=SPECIFICATION_ITEM, p=l-1={tt=Execution Management, e=SCHED_RR}  # Scheduling Round-Robin
                    item:
                      trace SWS_EM_01043: category=SPECIFICATION_ITEM, p=l-1={tt=Execution Management, e=SCHED_OTHER}  # Scheduling Other
                    trace SWS_EM_01015: category=SPECIFICATION_ITEM, p=l-1=[Execution Management, Process, Execution Manifest]  # Scheduling priority
                    chapter chap_3a_Resrce_Manent__68477b50:  # Resource Management
                      p=l-1=In general, for deterministic behavior the required computing time is guaranteed and violations are treated as error, while best-effort subsystems are more robust and might be able to mitigate sporadic violations, e.g. by continuing the calculation at the next activation, or by providing a result of lesser quality. This means, if time (e.g. deadline or runtime budget) monitoring is in place, the reaction on deviations is different for deterministic and best-effort subsystems.
                      p=l-1=In fact, it may not even be necessary to monitor best-effort subsystems, since they by definition are doing only a function that may not succeed. This leads to an architecture where monitoring is a voluntary, configured property.
                      p=l-1=The remaining critical property however is to guarantee that a particular process or set of Process cannot adversely affect the behavior of other Process.
                      p=l-1=To guarantee Full Determinism for the entire system, it is important to ensure Freedom from Interference, which the ResourceGroup contribute to ensure.
                      trace SWS_EM_02106: category=SPECIFICATION_ITEM, p=l-1=[Execution Management, Process, ResourceGroup]  # ResourceGroup assignment
                  sec_3a_ResMemory:  # Memory Budget and Monitoring
                    p=l-1=To render a function, a Process requires the availability of some amount of memory for its usage (mainly code, data, heap, thread stacks). Over the course of its execution however, not all of this memory is required at all times, such that an OS can take advantage of this property to make these ranges of memory available on-demand, and provide them to other Process when the memory is no longer used.
                    p=l-1=While this has clear advantages in terms of system flexibility as well as memory efficiency, it is also in the way of both Time Determinism and Full Determinism: when a range of memory that was previously unused should now be made available, the OS may have to execute some amounts of potentially-unbounded activities to make this memory available. Often, the reverse may also be happening, removing previously available (but unused) memory from the Process under scope, to make it available to other Process. This is detrimental to an overall system determinism.
                    p=l-1=[Execution Management, Process, Process]
                    p=l-1=Applications not configured to be deterministic may be mapped on-demand.
                    p=l-1=In order to provide sufficient memory at the beginning of the execution of a Process, some properties may need to be defined for each Process.
                    p=l-1=Heap memory is used for dynamic memory allocation inside a Process e.g. through malloc()/free() and new/delete.
                    p=l-1=System memory can be used to create extra resources like file handles or semaphores, as well as creating new threads.
                    p=l-1=Fully pre-mapping a Process ensures that code and data execution is not going to be delayed at its first execution by demand-loading. This helps providing Time Determinism during system startup and first execution phases, but also helps with safety where code handling error cases can be preloaded and made guaranteed to be available. In addition, pre-mapping avoids late issues where filesystem may be corrupted and part of the Process may not be loadable anymore.
                    trace SWS_EM_02107: category=SPECIFICATION_ITEM, p=l-1=[Execution Management, Process]  # Maximum heap
                    trace SWS_EM_02108: category=SPECIFICATION_ITEM, p=l-1=[Execution Management, Process]  # Maximum system memory usage
                    trace SWS_EM_02109: category=SPECIFICATION_ITEM, p=l-1=[Execution Management, Process, Execution Manifest]  # Process pre-mapping
                  sec_3a_WorkingFolder: p=l-1=The working folder of a process is not defined by configuration but rather is deliberately left as an implementation-specific element. The required PSE51 POSIX profile does not define that an (Adaptive) Application may use the path or file argument for any function using a file pathname (e.g., open), instead only to specify the name of the object without any file system semantics implied.  # Working Folder
            sect_3a_EMFaultTolerance  # Fault Tolerance
              chapter chap_3a_Intion__1f55e4ce:  # Introduction
                p=l-1=e=What is Fault-Tolerance?
                p=l-1=The method of coping with faults within a large-scale software system is termed fault tolerance.
                p=l-1=The model adopted for Execution Management is outlined in IEEEDependability.
                p=l-1=This section provides context to the application of fault tolerance concepts with respect to Execution Management and perspective on how this contributes in overall platform instance's dependability.
                p=l-1=Platform-wide Service Oriented Architecture fault tolerance aspects are outside the scope of this document and are not further addressed.
              chapter chap_3a_Scope__ffe59b6b:  # Scope
                p=l-1=[Execution Management, AUTOSAR Adaptive Platform]
                p=l-1=The effect of erroneous functionality, within Execution Management can have very different severity depending on operational mode and fault type. For example, a fault identified by Execution Management may have a local effect, influencing an independent process only, or may become a root cause for a Machine wide failures.
                p=l-1=It is therefore necessary to not only specify correct behavior but also to introduce alternative behavior in case of deviations.
                p=l-1=Such mechanisms address a broad spectrum of concerns that emerge during Machine and Process Life Cycle Management.
                p=l-1=The AUTOSAR Adaptive Platform architecture is composed of two levels; Application and Platform Instance. The Application level constitutes cooperative Applications intended to satisfy overal system's needs and objectives and represents a service level in vehicle context. The Platform Instance level as a reusable asset providing basic capabilities and platform level services. Fault tolerance within Execution Management is therefore required to handle both levels.
              chapter chap_3a_Threat_Model__2333e6c2:  # Threat Model
                p=l-1=The main threats which leading to incorrect behavior of software - whether Application or Platform Instance - is the presence of systematic defects or faults i.e. those incorporated during design phase and remaining dormant untill deployment. Other sources of faults include physical faults, e.g. random hardware failures, that might influence resource allocation and correct execution, and interraction faults which can be a source for incorrect state transition requests.
                p=l-1=From the perspective of Execution Management, fault activation occures when resulting Function Group State or combination of such is requested. Due to the different nature of faults, these can lead to various types of deviations from expected functional behavior and finally result in erroneous system functionality either in terms of correct computational results or timing response.
                p=l-1=In general, the implementation of fault tolerance mechanism is based on two consistent steps - Error Detection and subsequent Error Recovery. The major focus of Error Detection during Design Phase activities and thus the focus of Fault Tolerance in this specification is on the analysis of potential Failure Modes and the consequent error detection mechanisms that should later be incorporated into the implementation.
                p=l-1=In contrast, Error Recovery consists of actions that should be taken in order to restore the system's state where the system can once again perform correct service delivery. Binding of Error Detection and Recovery Actions should be a subject of platform wide fault tolerance model.
                p=l-1={e=Remark:, tt=Execution Management}
                figure caption fig_3a_FaultErrorFailure  # General Fault Tolerance scheme.
            sect_3a_EMSecurity  # Security
              chapter chap_3a_Truted_Plaorm__3ae216d3:  # Trusted Platform
                p=l-1=From a security perspective, it is essential that all software executed on the Adaptive Platform is trusted, i.e. the integrity and authenticity of the software is ensured. Execution Management - as the entity responsible for Process creation - shall take over this task.
                p=l-1=A key requirement for a trusted Adaptive Platform is a Trust Anchor on the Machine that is authentic by definition (hence that alternative name, "root of trust"). A Trust Anchor is often realized as a public key stored in a secure environment, e.g. in non-modifiable persistent memory or in an HSM. The trust has to be passed to Execution Management by appropriate means, e.g. by a chain of trust. If the Machine does not exhibit a Trust Anchor, it cannot be ensured that the Adaptive Platform is trusted.
                p=l-1=There are many ways to verify the integrity and authenticity of the Adaptive Platform. A Trusted Platform can be realized e.g. (but not limited to) by
                list=[p=l-1=Verification of the complete Ramdisk by the Bootloader, p=l-1=Verification of individual Executable and data files, e.g. using OS-functionalities or a trusted third-party process, p=l-1=Verification of individual memory pages upon being loaded, e.g. using OS-functionalities or a trusted third-party process]
                p=l-1=From a security perspective, the rationale for choosing these items is as follows:
                list=[p=l-1=tt=Executable, p=l-1=Manifests: Machine Manifest, Execution Manifest and Service Instance Manifest describe what and how something should be executed and are thus an obvious attack vector on the Adaptive Platform;, p=l-1=Shared Objects: Shared objects contain Executable code that is executed within the context of the Process. A modified shared object could consequently be used to compromise the system.]
                p=l-1=In order to establish a Trusted Platform, it must be ensured that only trusted software is launched. Therefore, a system designer has to ensure that Execution Management is started authentically. For instance, this could be realized by a chain of trust as described in EXP_2d_PlatformDesign.
                p=l-1=[Execution Management, Executable]
                p=l-1=The integrity and authenticity of persistent data stored by applications is not considered here. The Functional Cluster Persistency takes care of the integrity of this data.
                6 x trace, all with category=SPECIFICATION_ITEM:
                  SWS_EM_02299: p=l-1=If there is no Trust Anchor available on the Machine, the following requirements may be ignored: SWS_EM_02300, SWS_EM_02301, SWS_EM_02302, SWS_EM_02303, SWS_EM_02304, SWS_EM_02305, SWS_EM_02306, SWS_EM_02307, SWS_EM_02308, SWS_EM_02309.  # Availability of a Trust Anchor
                  SWS_EM_02300: p=l-1=[Execution Management, Machine Manifest]  # Integrity and Authenticity of processed Machine Manifest
                  SWS_EM_02301: p=l-1=[Execution Management, Process, Executable]  # Integrity and Authenticity of each Executable
                  SWS_EM_02302: p=l-1=[Execution Management, Process]  # Integrity and Authenticity of shared objects
                  SWS_EM_02303: p=l-1=[Execution Management, Process, Execution Manifest]  # Integrity and Authenticity of processed Execution Manifest
                  SWS_EM_02304: p=l-1=[Execution Management, Process, Service Instance Manifest]  # Integrity and Authenticity of processed Service Instance Manifest
                figure caption fig_3a_startup_authentic  # Authenticated start-up sequence
                chapter chap_3a_Haning_of_failed_autity_checks__02665a57: p=l-1=If the integrity and authenticity has been verified successfully, the system shall continue with its regular start-up process. If the integrity and authenticity check has failed, however, Execution Management shall offer a configuration option on how to proceed with the start-up process., p=l-1=The configuration of the two modes is done via the Machine Manifest. The configuration option shall only be processed after the integrity and authenticity of the Machine Manifest have been verified.  # Handling of failed authenticity checks
                  trace SWS_EM_02305: category=SPECIFICATION_ITEM, p=l-1=tt=Execution Management  # Failed authenticity checks
                  trace SWS_EM_02306: category=SPECIFICATION_ITEM, p=l-1=[Execution Management, Machine Manifest]  # Machine Manifest
                  chapter chap_3a_Moning_Mode__b9706061:  # Monitoring Mode
                    p=l-1=In Monitoring Mode, the integrity and authenticity checks are performed, but the start-up process is not affected. Hence, the Adaptive Platform starts up even if the file system has been compromised.
                    p=l-1=Monitoring Mode is useful when the integrator wants the system to keep running, even if the platform is not considered trusted. In this case, the integrator might use additional measures outside the scope of Adaptive AUTOSAR, like e.g. restricted key access when using an HSM that supports this feature.
                    p=l-1=Monitoring Mode is also useful during development phase, when frequent changes on the Adaptive Platform are performed and keeping the authentication tag (e.g. signatures) valid is a tedious task.
                  chapter chap_3a_Strict_Mode__f5df0246:  # Strict Mode
                    p=l-1=In Strict Mode, the Adaptive Platform ensures that no Process are executed, where the integrity and authenticity of the corresponding Executable, manifests or linked library could not be verified.
                    p=l-1=Executable code can be provided by executables, but also by shared objects that are linked by the executable.
                    p=l-1=Example: Consider an Adaptive Platform in Strict Mode. Execution Management has started several Executable after successfully verifying the integrity and authenticity of the Executable, its related shared objects and its processed Execution Manifest. Now, Execution Management wants to start another Executable, where the authenticity check has failed. Execution Management does not launch this Executable, because it is not trusted. The other Executable that passed the authenticity check may however continue to run. When Execution Management attempts to start another Executable it can be started as long as all authenticity checks are passed.
                    trace SWS_EM_02307: category=SPECIFICATION_ITEM, p=l-1=In Strict Mode, Execution Management shall not initiate the execution of an Executable if the integrity or authenticity check of the corresponding processed Execution Manifest has failed.  # Strict Mode - Execution manifest
                    trace SWS_EM_02308: category=SPECIFICATION_ITEM, p=l-1=In Strict Mode, Execution Management shall not initiate the execution of an Executable if the integrity or authenticity check of at least one of the corresponding processed Service Instance Manifest has failed.  # Strict Mode - Service Instance manifests
                    trace SWS_EM_02309: category=SPECIFICATION_ITEM, p=l-1=In Strict Mode, Execution Management shall execute code only if its integrity and authenticity check was successful.  # Strict Mode - Executables
        chap_3a_APISpec  # API specification
          chapter sec_3a_DefinedTypes  # Type Definitions
            4 x chapter:
              sec_3a_api_em_ExecutionState: msr-query-p-1=msr-query-props={msr-query-name=ARInput, msr-query-arg=AR_SwsApiTables_Type__ara_exec__ExecutionState, msr-query-arg=AR_SwsApiTables_Type__ara_exec__ExecutionState}, p=l-1=Please note that ExecutionState includes only states reportable by the Process to Execution Management and therefore does not include enumerations e.g. the "Initializing" state mentioned in figure fig_3a_ExecutionStates and fig_3a_StateInteraction, which are an implied states for Execution Management. The Initializing state starts when Process is first scheduled (so no code executed yet) and ends when ExecutionState.kRunning is reported (SWS_EM_01004). The Terminating state starts when Process first reports ExecutionState.kTerminating or termination is requested by Execution Management and ends when the Process terminates (SWS_EM_01404 and SWS_EM_01405). For the reasons mentioned, Execution Management assumes that Process is in initializing state until ExecutionState.kRunning will be reported by it.  # ExecutionState
              sec_3a_api_em_ExecutionReturnType: msr-query-p-1=msr-query-props={msr-query-name=ARInput, msr-query-arg=AR_SwsApiTables_Type__ara_exec__ExecutionStateReturnType, msr-query-arg=AR_SwsApiTables_Type__ara_exec__ExecutionStateReturnType}  # ExecutionStateReturnType
              sec_3a_api_em_ActivationReturnType: msr-query-p-1=msr-query-props={msr-query-name=ARInput, msr-query-arg=AR_SwsApiTables_Type__ara_exec__ActivationReturnType, msr-query-arg=AR_SwsApiTables_Type__ara_exec__ActivationReturnType}  # ActivationReturnType
              sec_3a_api_em_ActivationTimeStampReturnType: msr-query-p-1=msr-query-props={msr-query-name=ARInput, msr-query-arg=AR_SwsApiTables_Type__ara_exec__ActivationTimeStampReturnType, msr-query-arg=AR_SwsApiTables_Type__ara_exec__ActivationTimeStampReturnType}  # ActivationTimeStampReturnType
          chapter chap_3a_api_class_def  # Class Definitions
            4 x chapter:
              sec_3a_api_em_ExecutionClient_class: p=l-1=The Execution State API provides the functionality for a Process to report its state to the Execution Management., msr-query-p-1=msr-query-props={msr-query-name=ARInput, msr-query-arg=AR_SwsApiTables_Class__ara_exec_ExecutionClient, msr-query-arg=AR_SwsApiTables_Class__ara_exec_ExecutionClient}  # ExecutionClient class
                chapter sec_3a_api_em_ExecutionClient__Constructor: msr-query-p-1=msr-query-props={msr-query-name=ARInput, msr-query-arg=AR_SwsApiTables_Function__ara_exec_ExecutionClient__ExecutionClient__SWS_EM_02030, msr-query-arg=AR_SwsApiTables_Function__ara_exec_ExecutionClient__ExecutionClient__SWS_EM_02030}  # ExecutionClient::ExecutionClient
                chapter sec_3a_api_em_ExecutionClient__Destructor: msr-query-p-1=msr-query-props={msr-query-name=ARInput, msr-query-arg=AR_SwsApiTables_Function__ara_exec_ExecutionClient__Destructor__SWS_EM_02002, msr-query-arg=AR_SwsApiTables_Function__ara_exec_ExecutionClient__Destructor__SWS_EM_02002}  # ExecutionClient::~ExecutionClient
                chapter sec_3a_api_em_ExecutionClient__ReportExecutionState: msr-query-p-1=msr-query-props={msr-query-name=ARInput, msr-query-arg=AR_SwsApiTables_Function__ara_exec_ExecutionClient__ReportExecutionState__SWS_EM_02003, msr-query-arg=AR_SwsApiTables_Function__ara_exec_ExecutionClient__ReportExecutionState__SWS_EM_02003}  # ExecutionClient::ReportExecutionState
              sec_3a_api_em_DeterministicClient_class: p=l-1=The DeterministicClient class provides the functionality for an Application to run a cyclic deterministic execution, see sec_3a_DetExeCyclicDetExe. Each Process which needs support for cyclic deterministic execution has to instantiate this class., msr-query-p-1=msr-query-props={msr-query-name=ARInput, msr-query-arg=AR_SwsApiTables_Class__ara_exec_DeterministicClient, msr-query-arg=AR_SwsApiTables_Class__ara_exec_DeterministicClient}  # DeterministicClient class
                7 x chapter:
                  api_em_DeterministicClient__Constructor: msr-query-p-1=msr-query-props={msr-query-name=ARInput, msr-query-arg=AR_SwsApiTables_Function__ara_exec_DeterministicClient__DeterministicClient__SWS_EM_02211, msr-query-arg=AR_SwsApiTables_Function__ara_exec_DeterministicClient__DeterministicClient__SWS_EM_02211}  # DeterministicClient::DeterministicClient
                  sec_3a_api_em_DeterministicClient__Destructor: msr-query-p-1=msr-query-props={msr-query-name=ARInput, msr-query-arg=AR_SwsApiTables_Function__ara_exec_DeterministicClient__Destructor__SWS_EM_02215, msr-query-arg=AR_SwsApiTables_Function__ara_exec_DeterministicClient__Destructor__SWS_EM_02215}  # DeterministicClient::~DeterministicClient
                  sec_3a_api_em_DeterministicClient__WaitForNextActivation: msr-query-p-1=msr-query-props={msr-query-name=ARInput, msr-query-arg=AR_SwsApiTables_Function__ara_exec_DeterministicClient__WaitForNextActivation__SWS_EM_02216, msr-query-arg=AR_SwsApiTables_Function__ara_exec_DeterministicClient__WaitForNextActivation__SWS_EM_02216}  # DeterministicClient::WaitForNextActivation
                  sec_3a_api_em_DeterministicClient__RunWorkerPool: msr-query-p-1=msr-query-props={msr-query-name=ARInput, msr-query-arg=AR_SwsApiTables_Function__ara_exec_DeterministicClient__RunWorkerPool__SWS_EM_02220, msr-query-arg=AR_SwsApiTables_Function__ara_exec_DeterministicClient__RunWorkerPool__SWS_EM_02220}  # DeterministicClient::RunWorkerPool
                  sec_3a_api_em_DeterministicClient__GetRandom: msr-query-p-1=msr-query-props={msr-query-name=ARInput, msr-query-arg=AR_SwsApiTables_Function__ara_exec_DeterministicClient__GetRandom__SWS_EM_02225, msr-query-arg=AR_SwsApiTables_Function__ara_exec_DeterministicClient__GetRandom__SWS_EM_02225}  # DeterministicClient::GetRandom
                  sec_3a_api_em_DeterministicClient__GetActivationTime: msr-query-p-1=msr-query-props={msr-query-name=ARInput, msr-query-arg=AR_SwsApiTables_Function__ara_exec_DeterministicClient__GetActivationTime__SWS_EM_02230, msr-query-arg=AR_SwsApiTables_Function__ara_exec_DeterministicClient__GetActivationTime__SWS_EM_02230}  # DeterministicClient::GetActivationTime
                  sec_3a_api_em_DeterministicClient__GetNextActivationTime: msr-query-p-1=msr-query-props={msr-query-name=ARInput, msr-query-arg=AR_SwsApiTables_Function__ara_exec_DeterministicClient__GetNextActivationTime__SWS_EM_02235, msr-query-arg=AR_SwsApiTables_Function__ara_exec_DeterministicClient__GetNextActivationTime__SWS_EM_02235}  # DeterministicClient::GetNextActivationTime
              sec_3a_api_em_FunctionGroupState_class: p=l-1=An instance of this class will represent Function Group State defined inside meta-model (ARXML). This class is intended to be an implementation specific representation, of information inside meta-model. Once created based on ARXML path, it's internal value stay bounded to it for entire lifetime of a object., msr-query-p-1=msr-query-props={msr-query-name=ARInput, msr-query-arg=AR_SwsApiTables_Class__ara_exec_FunctionGroupState, msr-query-arg=AR_SwsApiTables_Class__ara_exec_FunctionGroupState}  # FunctionGroupState class
                5 x chapter:
                  api_em_FunctionGroupState__Preconstruct: msr-query-p-1=msr-query-props={msr-query-name=ARInput, msr-query-arg=AR_SwsApiTables_Function__ara_exec_FunctionGroupState__Preconstruct__SWS_EM_02270, msr-query-arg=AR_SwsApiTables_Function__ara_exec_FunctionGroupState__Preconstruct__SWS_EM_02270}  # FunctionGroupState::Preconstruct
                  api_em_FunctionGroupState__Constructor: msr-query-p-1=msr-query-props={msr-query-name=ARInput, msr-query-arg=AR_SwsApiTables_Function__ara_exec_FunctionGroupState__FunctionGroupState__SWS_EM_02271, msr-query-arg=AR_SwsApiTables_Function__ara_exec_FunctionGroupState__FunctionGroupState__SWS_EM_02271}  # FunctionGroupState::FunctionGroupState
                  sec_3a_api_em_FunctionGroupState__Destructor: msr-query-p-1=msr-query-props={msr-query-name=ARInput, msr-query-arg=AR_SwsApiTables_Function__ara_exec_FunctionGroupState__Destructor__SWS_EM_02272, msr-query-arg=AR_SwsApiTables_Function__ara_exec_FunctionGroupState__Destructor__SWS_EM_02272}  # FunctionGroupState::~FunctionGroupState
                  api_em_FunctionGroupState__operatoreq: msr-query-p-1=msr-query-props={msr-query-name=ARInput, msr-query-arg=AR_SwsApiTables_Function__ara_exec_FunctionGroupState__operator__SWS_EM_02273, msr-query-arg=AR_SwsApiTables_Function__ara_exec_FunctionGroupState__operator__SWS_EM_02273}  # FunctionGroupState::operator==
                  api_em_FunctionGroupState__operatorneq: msr-query-p-1=msr-query-props={msr-query-name=ARInput, msr-query-arg=AR_SwsApiTables_Function__ara_exec_FunctionGroupState__operator__SWS_EM_02274, msr-query-arg=AR_SwsApiTables_Function__ara_exec_FunctionGroupState__operator__SWS_EM_02274}  # FunctionGroupState::operator!=
              sec_3a_api_em_StateClient_class: p=l-1=Class used to perform Function Group state management operation needed during lifetime of a Machine. State Management during its own lifetime will need to start and stop software, that is intended to run on a Machine managed by it. This can be achieved by performing state transition of a Function Group to which required software is assigned. Integrator will assign software to run in a particular state (of Function Group) and State Management can start it, by requesting Execution Management to perform state transition (of this Function Group) to the mentioned state. Execution Management will then start mentioned software and report transition result back to State Management. Please note that stopping software can be done in similar way (i.e. Function Group state transition, to a state in which software is not configured to be run)., msr-query-p-1=msr-query-props={msr-query-name=ARInput, msr-query-arg=AR_SwsApiTables_Class__ara_exec_StateClient, msr-query-arg=AR_SwsApiTables_Class__ara_exec_StateClient}  # StateClient class
                4 x chapter:
                  api_em_StateClient__Constructor: msr-query-p-1=msr-query-props={msr-query-name=ARInput, msr-query-arg=AR_SwsApiTables_Function__ara_exec_StateClient__StateClient__SWS_EM_02276, msr-query-arg=AR_SwsApiTables_Function__ara_exec_StateClient__StateClient__SWS_EM_02276}  # StateClient::StateClient
                  sec_3a_api_em_StateClient__Destructor: msr-query-p-1=msr-query-props={msr-query-name=ARInput, msr-query-arg=AR_SwsApiTables_Function__ara_exec_StateClient__Destructor__SWS_EM_02277, msr-query-arg=AR_SwsApiTables_Function__ara_exec_StateClient__Destructor__SWS_EM_02277}  # StateClient::~StateClient
                  api_em_StateClient__SetState:  # StateClient::SetState
                    msr-query-p-1=msr-query-props={msr-query-name=ARInput, msr-query-arg=AR_SwsApiTables_Function__ara_exec_StateClient__SetState__SWS_EM_02278, msr-query-arg=AR_SwsApiTables_Function__ara_exec_StateClient__SetState__SWS_EM_02278}
                    p=l-1=Asynchronous nature of StateClient::SetState makes the returned ara::core::Future dependable on lifetime of the instance from which it was received. It is expected that once state change request is received by Execution Management, it will be processed independently of lifetime of the instance from which it was requested. Once finished it is implementation specific if answer will arrive on the corresponding future.
                    p=l-1=Since Execution Management allows to change direction of the ongoing Function Group state transition, it may happen (especially in misconfigured system, or during the development phase) that some of StateClient::SetState requests will be issued by mistake. It is in the best interest of Execution Management to inform requester (instance of StateClient) of the ongoing transition, that it had been canceled by a newer request as soon as possible.
                    p=l-1=Please note that SWS_EM_02298 merely ensures that Execution Management first informs requester of the ongoing transition (instance of StateClient) about cancellation, before informing new requester that the new request has been accepted. Both requesters could be the same instance of StateClient. There are no other requirements or assumtions on order in which requests from StateClient::SetState are processed.
                    trace SWS_EM_02298: category=SPECIFICATION_ITEM, p=l-1=When Execution Management receives StateClient::SetState request for a Function Group that is already under state transition. Execution Management shall cancel the ongoing state transition, by sending StateClientReturnType.kCancelled transition result to requestor, before accepting new request.  # Canceling ongoing state transition
                  api_em_StateClient__GetInitialMachineStateTransitionResult: msr-query-p-1=msr-query-props={msr-query-name=ARInput, msr-query-arg=AR_SwsApiTables_Function__ara_exec_StateClient__GetInitialMachineStateTransitionResult__SWS_EM_02279, msr-query-arg=AR_SwsApiTables_Function__ara_exec_StateClient__GetInitialMachineStateTransitionResult__SWS_EM_02279}, p=l-1=Please note that concerns about returned ara::core::Future from StateClient::SetState apply for StateClient::GetInitialMachineStateTransitionResult.  # StateClient::GetInitialMachineStateTransitionResult
        chap_3a_ServiceInterfaces: p=l-1=This chapter lists all provided and required service interfaces of the Execution Management., p=l-1=There are no service interfaces defined in this release.  # Service Interfaces
        chap_3a_Appdix__baafdab4  # Appendix
        chap_3a_Appdix__baafdab4  # Appendix
          chapter chap_3a_MentionedClassTables:  # Mentioned Manifest Elements
            p=l-1=For the sake of completeness, this chapter contains a set of class tables representing meta-classes mentioned in the context of this document but which are not contained directly in the scope of describing specific meta-model semantics.
            msr-query-p-1=msr-query-props={msr-query-name=ARInput, msr-query-arg=AR_MetaModel_CommandLineOptionKindEnum, msr-query-arg=AR_MetaModel_CommandLineOptionKindEnum}
            msr-query-p-1=msr-query-props={msr-query-name=ARInput, msr-query-arg=AR_MetaModel_DeterministicClient, msr-query-arg=AR_MetaModel_DeterministicClient}
            msr-query-p-1=msr-query-props={msr-query-name=ARInput, msr-query-arg=AR_MetaModel_DeterministicClientResource, msr-query-arg=AR_MetaModel_DeterministicClientResource}
            msr-query-p-1=msr-query-props={msr-query-name=ARInput, msr-query-arg=AR_MetaModel_DeterministicClientResourceNeeds, msr-query-arg=AR_MetaModel_DeterministicClientResourceNeeds}
            msr-query-p-1=msr-query-props={msr-query-name=ARInput, msr-query-arg=AR_MetaModel_Executable, msr-query-arg=AR_MetaModel_Executable}
            msr-query-p-1=msr-query-props={msr-query-name=ARInput, msr-query-arg=AR_MetaModel_ExecutionStateReportingBehaviorEnum, msr-query-arg=AR_MetaModel_ExecutionStateReportingBehaviorEnum}
            msr-query-p-1=msr-query-props={msr-query-name=ARInput, msr-query-arg=AR_MetaModel_Machine, msr-query-arg=AR_MetaModel_Machine}
            msr-query-p-1=msr-query-props={msr-query-name=ARInput, msr-query-arg=AR_MetaModel_ModeDeclaration, msr-query-arg=AR_MetaModel_ModeDeclaration}
            msr-query-p-1=msr-query-props={msr-query-name=ARInput, msr-query-arg=AR_MetaModel_NormalizedInstruction, msr-query-arg=AR_MetaModel_NormalizedInstruction}
            msr-query-p-1=msr-query-props={msr-query-name=ARInput, msr-query-arg=AR_MetaModel_Process, msr-query-arg=AR_MetaModel_Process}
            msr-query-p-1=msr-query-props={msr-query-name=ARInput, msr-query-arg=AR_MetaModel_StartupConfig, msr-query-arg=AR_MetaModel_StartupConfig}
            msr-query-p-1=msr-query-props={msr-query-name=ARInput, msr-query-arg=AR_MetaModel_StartupOption, msr-query-arg=AR_MetaModel_StartupOption}
            msr-query-p-1=msr-query-props={msr-query-name=ARInput, msr-query-arg=AR_MetaModel_StateDependentStartupConfig, msr-query-arg=AR_MetaModel_StateDependentStartupConfig}
            msr-query-p-1=msr-query-props={msr-query-name=ARInput, msr-query-arg=AR_MetaModel_TagWithOptionalValue, msr-query-arg=AR_MetaModel_TagWithOptionalValue}
          chapter chap_3a_IfcInterfaces  # Interfaces to other Functional Clusters (informative)
            chapter sec_3a_IfcIfOverview:  # Overview
              p=l-1=AUTOSAR decided not to standardize interfaces which are exclusively used between Functional Clusters (on platform-level only), to allow efficient implementations, which might depend e.g. on the used Operating System.
              p=l-1=This chapter provides informative guidelines how the interaction between Functional Clusters looks like, by clustering the relevant requirements of this document to describe Inter-Functional Cluster (IFC) interfaces. In addition, the standardized public interfaces which are accessible by user space applications (see chapters chap_3a_APISpec and chap_3a_ServiceInterfaces) can also be used for interaction between Functional Clusters.
              p=l-1=The goal is to provide a clear understanding of Functional Cluster boundaries and interaction, without specifying syntactical details. This ensures compatibility between documents specifying different Functional Clusters and supports parallel implementation of different Functional Clusters. Details of the interfaces are up to the platform provider. Additional interfaces, parameters and return values can be added.
              figure caption fig_3a_IFCInterfacesOverview  # Interfaces between Functional Clusters
            chapter sec_3a_IfcIfTables  # Interface Tables
              chapter chap_3a_Get_Proess_States_Infion__830b54fd  # Get Process States Information
                table tgroup=tbody=[[p=l-1=Name, p=l-1=Description, p=l-1=Requirements], [p=l-1=e=Intended users, p=l-1=Platform Health Management], [p=l-1=e=Name proposal, p=l-1=*GetProcessStates*], [p=l-1=e=Functionality, p=l-1=Get information about currently running processes, p=l-1=The Execution Management provides an interface to receive a list of the currently running processes. With this information the Platform Health Management can identify, based on Manifest information, if an how each process should be monitored. This polling API could be e.g. called once after startup and maintained by the information received via the reporting API specified in Platform Health Management., p=l-1=SWS_EM_02076], [p=l-1=e=Parameters (in), p=l-1=None], [p=l-1=e=Parameters (inout), p=l-1=None], [p=l-1=e=Parameters (out), p=l-1=Processes, p=l-1=List of Currently running processes.], [p=l-1=e=Return value, p=l-1=Operation succeeded], [p=l-1=Execution Management is busy and cannot provide requested information], [p=l-1=general error]]:
                  table caption GetProcessStatesInformation  # Get Process States Information
              chapter chap_3a_Enter_Unrble_State_Reqest__280e0257  # Enter Unrecoverable State Request
                table tgroup=tbody=[[p=l-1=Name, p=l-1=Description, p=l-1=Requirements], [p=l-1=e=Intended users, p=l-1=Platform Health Management, p=l-1=This is a "Recovery Action"], [p=l-1=e=Name proposal, p=l-1=*EnterUnrecoverableState*], [p=l-1=e=Functionality, p=l-1=Requests a change to a Unrecoverable State and stops all currently running processes, p=l-1=[SWS_EM_02261, SWS_EM_02262]], [p=l-1=e=Parameters (in), p=l-1=None], [p=l-1=e=Parameters (inout), p=l-1=None], [p=l-1=e=Parameters (out), p=l-1=None], [p=l-1=e=Return value, p=l-1=Operation failed, p=l-1=This API will never return in normal operation. Therfore any actual return always indicate an error.]]:
                  table caption EnterUnrecoverableStateRequest  # Enter Unrecoverable State Request
              chapter sec_3a_IfcIfProcessRestartRequest  # Process Restart Request
                table tgroup=tbody=[[p=l-1=Name, p=l-1=Description, p=l-1=Requirements], [p=l-1=e=Intended users, p=l-1=Platform Health Management, p=l-1=This is a "Recovery Action"], [p=l-1=e=Name proposal, p=l-1=*ProcessRestart*], [p=l-1=e=Functionality, p=l-1=Request to restart a Process, p=l-1=Restart a specific Process on the request from the Platform Health Management., p=l-1=[SWS_EM_01016, SWS_EM_01062]], [p=l-1=e=Parameters (in), p=l-1=Process identifier, p=l-1=Unique named identifier of the Process to be restarted. Not the PID because this will change., p=l-1=SWS_EM_01016], [p=l-1=e=Parameters (inout), p=l-1=None], [p=l-1=e=Parameters (out), p=l-1=None], [p=l-1=e=Return value, p=l-1=Operation succeeded, p=l-1=SWS_EM_01064], [p=l-1=general error, p=l-1=Process could not be restarted, p=l-1=SWS_EM_01063]]:
                  table caption ProcessRestartRequest  # Process Restart Request
          chapter chap_3a_ConstraintHistory: p=l-1=Please note that the lists in this chapter also include constraints and specification items that have been removed from the specification in a later version. These constraints and specification items do not appear as hyperlinks in the document.  # History of Constraints and Specification Items
            chapter chap_3a_ConstraintHistory1710  # Constraint and Specification Item History of this document according to AUTOSAR Release 17-10
              6 x chapter:
                chap_3a_Added_Trales_in_17_2d_10__a3cbdd3d  # Added Traceables in 17-10
                  table tgroup={thead=row=[p=l-1=e=Number, p=l-1=e=Heading], tbody=[[p=l-1=tt=SWS_EM_01001, p=l-1=Execution Dependency error], [p=l-1=tt=SWS_EM_01016, p=l-1=RestartProcess API], [p=l-1=tt=SWS_EM_01018, p=l-1=tt=OverrideState], [p=l-1=tt=SWS_EM_01032, p=l-1=Machine States], [p=l-1=tt=SWS_EM_01061, p=l-1=OverrideState API interrupt], [p=l-1=tt=SWS_EM_01062, p=l-1=RestartProcess behaviour], [p=l-1=tt=SWS_EM_01107, p=l-1=Function Group name], [p=l-1=tt=SWS_EM_01108, p=l-1=Function Group State], [p=l-1=tt=SWS_EM_01109, p=l-1=State References], [p=l-1=tt=SWS_EM_01110, p=l-1=Off States], [p=l-1=tt=SWS_EM_01111, p=l-1=No reference to Off State], [p=l-1=tt=SWS_EM_01112, p=l-1=StartupConfig], [p=l-1=tt=SWS_EM_01201, p=l-1=Core Binding], [p=l-1=tt=SWS_EM_02041, p=l-1=ResetCause Enumeration], [p=l-1=tt=SWS_EM_02042, p=l-1=ApplicationClient::SetLastResetCause API], [p=l-1=tt=SWS_EM_02043, p=l-1=ApplicationClient::GetLastResetCause API], [p=l-1=tt=SWS_EM_02044, p=l-1=Machine State change in progress], [p=l-1=tt=SWS_EM_02047, p=l-1=StateClient::GetState API], [p=l-1=tt=SWS_EM_02048, p=l-1=Function Group State change in progress], [p=l-1=tt=SWS_EM_02049, p=l-1=State change failed], [p=l-1=tt=SWS_EM_02050, p=l-1=State change successful], [p=l-1=tt=SWS_EM_02051, p=l-1=Machine State change in progress], [p=l-1=tt=SWS_EM_02054, p=l-1=StateClient::SetState API], [p=l-1=tt=SWS_EM_02055, p=l-1=Function Group State change in progress], [p=l-1=tt=SWS_EM_02056, p=l-1=State change failed], [p=l-1=tt=SWS_EM_02057, p=l-1=State change successful], [p=l-1=tt=SWS_EM_02070, p=l-1=ApplicationReturnType Enumeration], [p=l-1=tt=SWS_EM_02071], [p=l-1=tt=SWS_EM_02072, p=l-1=Retrieving Machine State], [p=l-1=tt=SWS_EM_02073, p=l-1=Retrieving Function Group State], [p=l-1=tt=SWS_EM_02074, p=l-1=Setting Machine State], [p=l-1=tt=SWS_EM_02075, p=l-1=Setting Function Group State], [p=l-1=tt=SWS_EM_NA]]}:
                    table caption Added_Traceables_in_17_10  # Added Traceables in 17-10
                chap_3a_Chaged_Trales_in_17_2d_10__1005185f  # Changed Traceables in 17-10
                  table tgroup={thead=row=[p=l-1=e=Number, p=l-1=e=Heading], tbody=[[p=l-1=tt=SWS_EM_01000, p=l-1=Startup order], [p=l-1=tt=SWS_EM_01002, p=l-1=Idle Process State], [p=l-1=tt=SWS_EM_01003, p=l-1=Starting Process State], [p=l-1=tt=SWS_EM_01004, p=l-1=Running Process State], [p=l-1=tt=SWS_EM_01005, p=l-1=Terminating Process State], [p=l-1=tt=SWS_EM_01006, p=l-1=Terminated Process State], [p=l-1=tt=SWS_EM_01012, p=l-1=Application Argument Passing], [p=l-1=tt=SWS_EM_01013, p=l-1=Machine State and Function Group State], [p=l-1=tt=SWS_EM_01014, p=l-1=Scheduling policy], [p=l-1=tt=SWS_EM_01015, p=l-1=Scheduling priority], [p=l-1=tt=SWS_EM_01017, p=l-1=Application Binary Name], [p=l-1=tt=SWS_EM_01023, p=l-1=Machine State Startup], [p=l-1=tt=SWS_EM_01024, p=l-1=Machine State Shutdown], [p=l-1=tt=SWS_EM_01025, p=l-1=Machine State Restart], [p=l-1=tt=SWS_EM_01026, p=l-1=State change], [p=l-1=tt=SWS_EM_01028, p=l-1=GetState API], [p=l-1=tt=SWS_EM_01030, p=l-1=Start of Application execution], [p=l-1=tt=SWS_EM_01033, p=l-1=Application start-up configuration], [p=l-1=tt=SWS_EM_01034, p=l-1=Deny State change request], [p=l-1=tt=SWS_EM_01035, p=l-1=Machine State Restart behavior], [p=l-1=tt=SWS_EM_01036, p=l-1=Machine State Shutdown behavior], [p=l-1=tt=SWS_EM_01037, p=l-1=Machine State Startup behavior], [p=l-1=tt=SWS_EM_01039, p=l-1=Scheduling priority range for SCHED_FIFO and SCHED_RR], [p=l-1=tt=SWS_EM_01040, p=l-1=Scheduling priority range for SCHED_OTHER], [p=l-1=tt=SWS_EM_01041, p=l-1=Scheduling FIFO], [p=l-1=tt=SWS_EM_01042, p=l-1=Scheduling Round-Robin], [p=l-1=tt=SWS_EM_01043, p=l-1=Scheduling Other], [p=l-1=tt=SWS_EM_01050, p=l-1=Start dependent Application Executables], [p=l-1=tt=SWS_EM_01051, p=l-1=Shutdown Application Executables], [p=l-1=tt=SWS_EM_01053, p=l-1=Application State Running], [p=l-1=tt=SWS_EM_01055, p=l-1=Application State Termination], [p=l-1=tt=SWS_EM_01056, p=l-1=State Manager], [p=l-1=tt=SWS_EM_01058, p=l-1=Shutdown of the Operating System], [p=l-1=tt=SWS_EM_01059, p=l-1=Restart of the Operating System], [p=l-1=tt=SWS_EM_01060, p=l-1=State change behavior], [p=l-1=tt=SWS_EM_02000, p=l-1=ApplicationState Enumeration], [p=l-1=tt=SWS_EM_02001], [p=l-1=tt=SWS_EM_02002, p=l-1=ApplicationClient::~ApplicationClient API], [p=l-1=tt=SWS_EM_02003, p=l-1=ApplicationClient::ReportApplicationState API], [p=l-1=tt=SWS_EM_02005, p=l-1=StateReturnType Enumeration], [p=l-1=tt=SWS_EM_02006], [p=l-1=tt=SWS_EM_02007, p=l-1=StateClient::StateClient API], [p=l-1=tt=SWS_EM_02008, p=l-1=StateClient::~StateClient API], [p=l-1=tt=SWS_EM_02030, p=l-1=ApplicationClient::ApplicationClient API], [p=l-1=tt=SWS_EM_02031, p=l-1=Application State Reporting]]}:
                    table caption Changed_Traceables_in_17_10  # Changed Traceables in 17-10
                chap_3a_Dltd_Trales_in_17_2d_10__d069a225  # Deleted Traceables in 17-10
                  table tgroup={thead=row=[p=l-1=e=Number, p=l-1=e=Heading], tbody=[[p=l-1=tt=SWS_EM_00017, p=l-1=Application Processes], [p=l-1=tt=SWS_EM_01027, p=l-1=Rejection of Client Requests], [p=l-1=tt=SWS_EM_01029, p=l-1=tt=SetMachineState], [p=l-1=tt=SWS_EM_01052, p=l-1=Application State Initializing], [p=l-1=tt=SWS_EM_01057, p=l-1=Machine State Change arbitration], [p=l-1=tt=SWS_EM_02009], [p=l-1=tt=SWS_EM_02014], [p=l-1=tt=SWS_EM_02019], [p=l-1=tt=SWS_EM_99999]]}:
                    table caption Deleted_Traceables_in_17_10  # Deleted Traceables in 17-10
                chap_3a_Added_Connts_in_17_2d_10__f414b543: p=l-1=none  # Added Constraints in 17-10
                chap_3a_Chaged_Connts_in_17_2d_10__bc4f82ce: p=l-1=none  # Changed Constraints in 17-10
                chap_3a_Dltd_Connts_in_17_2d_10__99a87077: p=l-1=none  # Deleted Constraints in 17-10
            chapter chap_3a_ConstraintHistory1803  # Constraint and Specification Item History of this document according to AUTOSAR Release 18-03
              6 x chapter:
                chap_3a_Added_Trales_in_18_2d_03__4bb794fc  # Added Traceables in 18-03
                  table tgroup={thead=row=[p=l-1=e=Number, p=l-1=e=Heading], tbody=[[p=l-1=tt=SWS_EM_01044, p=l-1=Machine States Identification], [p=l-1=tt=SWS_EM_01063, p=l-1=Process Restart Failed], [p=l-1=tt=SWS_EM_01064, p=l-1=Process Restart Successful], [p=l-1=tt=SWS_EM_01065, p=l-1=Shutdown state timeout monitoring behavior], [p=l-1=tt=SWS_EM_01066, p=l-1=Start state change behavior], [p=l-1=tt=SWS_EM_01067, p=l-1=Confirm State Changes], [p=l-1=tt=SWS_EM_01068, p=l-1=Report start-up timeout], [p=l-1=tt=SWS_EM_01069, p=l-1=Self-terminating Process State], [p=l-1=tt=SWS_EM_01070, p=l-1=Acknowledgement of termination request], [p=l-1=tt=SWS_EM_01071, p=l-1=Initiation of Process self-termination], [p=l-1=tt=SWS_EM_01072, p=l-1=Application Argument Zero], [p=l-1=tt=SWS_EM_01073, p=l-1=Simple Arguments], [p=l-1=tt=SWS_EM_01074, p=l-1=Short form arguments with option value], [p=l-1=tt=SWS_EM_01075, p=l-1=Short form Arguments without option value], [p=l-1=tt=SWS_EM_01076, p=l-1=Long form Arguments with option value], [p=l-1=tt=SWS_EM_01077, p=l-1=Long form Arguments without option value], [p=l-1=tt=SWS_EM_01301, p=l-1=Cyclic Execution], [p=l-1=tt=SWS_EM_01302, p=l-1=Cyclic Execution Control], [p=l-1=tt=SWS_EM_01305, p=l-1=Worker Pool], [p=l-1=tt=SWS_EM_01308, p=l-1=Random Numbers], [p=l-1=tt=SWS_EM_01310, p=l-1=Get Activation Time], [p=l-1=tt=SWS_EM_01311, p=l-1=Activation Time Unknown], [p=l-1=tt=SWS_EM_01312, p=l-1=Get Next Activation Time], [p=l-1=tt=SWS_EM_01313, p=l-1=Next Activation Time Unknown], [p=l-1=tt=SWS_EM_02058, p=l-1=State Transition Timeout], [p=l-1=tt=SWS_EM_02102, p=l-1=Memory control], [p=l-1=tt=SWS_EM_02103, p=l-1=CPU usage control], [p=l-1=tt=SWS_EM_02104, p=l-1=Core affinity], [p=l-1=tt=SWS_EM_02106, p=l-1=ResourceGroup assignment], [p=l-1=tt=SWS_EM_02107, p=l-1=Maximum heap], [p=l-1=tt=SWS_EM_02108, p=l-1=Maximum system memory usage], [p=l-1=tt=SWS_EM_02109, p=l-1=Process pre-mapping], [p=l-1=tt=SWS_EM_02201, p=l-1=ActivationReturnType Enumeration], [p=l-1=tt=SWS_EM_02202, p=l-1=ActivationTimeStampReturnType Enumeration], [p=l-1=tt=SWS_EM_02210], [p=l-1=tt=SWS_EM_02211, p=l-1=DeterministicClient::DeterministicClient API], [p=l-1=tt=SWS_EM_02215, p=l-1=DeterministicClient::~DeterministicClient API], [p=l-1=tt=SWS_EM_02216, p=l-1=DeterministicClient::WaitForNextActivation API], [p=l-1=tt=SWS_EM_02220, p=l-1=DeterministicClient::RunWorkerPool API], [p=l-1=tt=SWS_EM_02225, p=l-1=DeterministicClient::GetRandom API], [p=l-1=tt=SWS_EM_02230, p=l-1=DeterministicClient::GetActivationTime API], [p=l-1=tt=SWS_EM_02235, p=l-1=DeterministicClient::GetNextActivationTime API]]}:
                    table caption Added_Traceables_in_18_03  # Added Traceables in 18-03
                chap_3a_Chaged_Trales_in_18_2d_03__ae23b732  # Changed Traceables in 18-03
                  table tgroup={thead=row=[p=l-1=e=Number, p=l-1=e=Heading], tbody=[[p=l-1=tt=SWS_EM_01000, p=l-1=Startup order], [p=l-1=tt=SWS_EM_01001, p=l-1=Execution Dependency error], [p=l-1=tt=SWS_EM_01002, p=l-1=Idle Process State], [p=l-1=tt=SWS_EM_01003, p=l-1=Starting Process State], [p=l-1=tt=SWS_EM_01004, p=l-1=Running Process State], [p=l-1=tt=SWS_EM_01005, p=l-1=Terminating Process State], [p=l-1=tt=SWS_EM_01006, p=l-1=Terminated Process State], [p=l-1=tt=SWS_EM_01012, p=l-1=Application Argument Passing], [p=l-1=tt=SWS_EM_01013, p=l-1=Machine State and Function Group State], [p=l-1=tt=SWS_EM_01014, p=l-1=Scheduling policy], [p=l-1=tt=SWS_EM_01015, p=l-1=Scheduling priority], [p=l-1=tt=SWS_EM_01016, p=l-1=Restart Process], [p=l-1=tt=SWS_EM_01018, p=l-1=Override State], [p=l-1=tt=SWS_EM_01023, p=l-1=Machine State Startup], [p=l-1=tt=SWS_EM_01024, p=l-1=Machine State Shutdown], [p=l-1=tt=SWS_EM_01025, p=l-1=Machine State Restart], [p=l-1=tt=SWS_EM_01026, p=l-1=State Change], [p=l-1=tt=SWS_EM_01028, p=l-1=Get State Information], [p=l-1=tt=SWS_EM_01030, p=l-1=Start of Process execution], [p=l-1=tt=SWS_EM_01032, p=l-1=Machine States Obtainment], [p=l-1=tt=SWS_EM_01033, p=l-1=Application start-up configuration], [p=l-1=tt=SWS_EM_01034, p=l-1=Deny State Change Request], [p=l-1=tt=SWS_EM_01035, p=l-1=Machine State Restart behavior], [p=l-1=tt=SWS_EM_01036, p=l-1=Machine State Shutdown behavior], [p=l-1=tt=SWS_EM_01037, p=l-1=Machine State Startup behavior], [p=l-1=tt=SWS_EM_01041, p=l-1=Scheduling FIFO], [p=l-1=tt=SWS_EM_01042, p=l-1=Scheduling Round-Robin], [p=l-1=tt=SWS_EM_01043, p=l-1=Scheduling Other], [p=l-1=tt=SWS_EM_01050, p=l-1=Start Dependent Processes], [p=l-1=tt=SWS_EM_01051, p=l-1=Shutdown Processes], [p=l-1=tt=SWS_EM_01053, p=l-1=Application State Running], [p=l-1=tt=SWS_EM_01055, p=l-1=Initiation of Process termination], [p=l-1=tt=SWS_EM_01058, p=l-1=Shutdown of the Operating System], [p=l-1=tt=SWS_EM_01059, p=l-1=Restart of the Operating System], [p=l-1=tt=SWS_EM_01060, p=l-1=Shutdown state change behavior], [p=l-1=tt=SWS_EM_01061, p=l-1=Override State Interrupt], [p=l-1=tt=SWS_EM_01062, p=l-1=Restart Process Behavior], [p=l-1=tt=SWS_EM_01107, p=l-1=Function Group name], [p=l-1=tt=SWS_EM_01108, p=l-1=Function Group State], [p=l-1=tt=SWS_EM_01109, p=l-1=State References], [p=l-1=tt=SWS_EM_01110, p=l-1=Off States], [p=l-1=tt=SWS_EM_02001], [p=l-1=tt=SWS_EM_02044, p=l-1=State Change in Progress], [p=l-1=tt=SWS_EM_02049, p=l-1=State Change Failed], [p=l-1=tt=SWS_EM_02050, p=l-1=State Information Success], [p=l-1=tt=SWS_EM_02056, p=l-1=State Change Failed], [p=l-1=tt=SWS_EM_02057, p=l-1=State Change Successful], [p=l-1=tt=SWS_EM_NA]]}:
                    table caption Changed_Traceables_in_18_03  # Changed Traceables in 18-03
                chap_3a_Dltd_Trales_in_18_2d_03__b3a623e4  # Deleted Traceables in 18-03
                  table tgroup={thead=row=[p=l-1=e=Number, p=l-1=e=Heading], tbody=[[p=l-1=tt=SWS_EM_01017, p=l-1=Application Binary Name], [p=l-1=tt=SWS_EM_01056, p=l-1=State Manager], [p=l-1=tt=SWS_EM_01112, p=l-1=StartupConfig], [p=l-1=tt=SWS_EM_01201, p=l-1=Core Binding], [p=l-1=tt=SWS_EM_02005, p=l-1=StateReturnType Enumeration], [p=l-1=tt=SWS_EM_02006], [p=l-1=tt=SWS_EM_02007, p=l-1=StateClient::StateClient API], [p=l-1=tt=SWS_EM_02008, p=l-1=StateClient::~StateClient API], [p=l-1=tt=SWS_EM_02031, p=l-1=Application State Reporting], [p=l-1=tt=SWS_EM_02041, p=l-1=ResetCause Enumeration], [p=l-1=tt=SWS_EM_02042, p=l-1=ApplicationClient::SetLastResetCause API], [p=l-1=tt=SWS_EM_02043, p=l-1=ApplicationClient::GetLastResetCause API], [p=l-1=tt=SWS_EM_02047, p=l-1=StateClient::GetState API], [p=l-1=tt=SWS_EM_02048, p=l-1=Function Group State change in progress], [p=l-1=tt=SWS_EM_02051, p=l-1=Machine State change in progress], [p=l-1=tt=SWS_EM_02054, p=l-1=StateClient::SetState API], [p=l-1=tt=SWS_EM_02055, p=l-1=Function Group State change in progress], [p=l-1=tt=SWS_EM_02071], [p=l-1=tt=SWS_EM_02072, p=l-1=Retrieving Machine State], [p=l-1=tt=SWS_EM_02073, p=l-1=Retrieving Function Group State], [p=l-1=tt=SWS_EM_02074, p=l-1=Setting Machine State], [p=l-1=tt=SWS_EM_02075, p=l-1=Setting Function Group State]]}:
                    table caption Deleted_Traceables_in_18_03  # Deleted Traceables in 18-03
                chap_3a_Added_Connts_in_18_2d_03__8a9562be: p=l-1=none  # Added Constraints in 18-03
                chap_3a_Chaged_Connts_in_18_2d_03__5e8c6b6e: p=l-1=none  # Changed Constraints in 18-03
                chap_3a_Dltd_Connts_in_18_2d_03__a7f4f9d8: p=l-1=none  # Deleted Constraints in 18-03
            chapter chap_3a_ConstraintHistory1810  # Constraint and Specification Item History of this document according to AUTOSAR Release 18-10
              6 x chapter:
                chap_3a_Added_Trales_in_18_2d_10__85e24b8e: p=l-1=none  # Added Traceables in 18-10
                chap_3a_Chaged_Trales_in_18_2d_10__b1dfd720  # Changed Traceables in 18-10
                  table tgroup={thead=row=[p=l-1=e=Number, p=l-1=e=Heading], tbody=[[p=l-1=tt=SWS_EM_01000, p=l-1=Startup order], [p=l-1=tt=SWS_EM_01001, p=l-1=Execution Dependency error], [p=l-1=tt=SWS_EM_01004, p=l-1=Running Process State], [p=l-1=tt=SWS_EM_01005, p=l-1=Terminating Process State], [p=l-1=tt=SWS_EM_01012, p=l-1=Process Argument Passing], [p=l-1=tt=SWS_EM_01013, p=l-1=Machine State and Function Group State], [p=l-1=tt=SWS_EM_01014, p=l-1=Scheduling policy], [p=l-1=tt=SWS_EM_01015, p=l-1=Scheduling priority], [p=l-1=tt=SWS_EM_01018, p=l-1=Override State], [p=l-1=tt=SWS_EM_01023, p=l-1=Machine State Startup], [p=l-1=tt=SWS_EM_01024, p=l-1=Machine State Shutdown], [p=l-1=tt=SWS_EM_01025, p=l-1=Machine State Restart], [p=l-1=tt=SWS_EM_01026, p=l-1=State Change], [p=l-1=tt=SWS_EM_01028, p=l-1=Get State Information], [p=l-1=tt=SWS_EM_01033, p=l-1=Process start-up configuration], [p=l-1=tt=SWS_EM_01034, p=l-1=Deny State Change Request], [p=l-1=tt=SWS_EM_01035, p=l-1=Machine State Restart behavior], [p=l-1=tt=SWS_EM_01036, p=l-1=Machine State Shutdown behavior], [p=l-1=tt=SWS_EM_01037, p=l-1=Machine State Startup behavior], [p=l-1=tt=SWS_EM_01039, p=l-1=Scheduling priority range for SCHED_FIFO and SCHED_RR], [p=l-1=tt=SWS_EM_01040, p=l-1=Scheduling priority range for SCHED_OTHER], [p=l-1=tt=SWS_EM_01041, p=l-1=Scheduling FIFO], [p=l-1=tt=SWS_EM_01042, p=l-1=Scheduling Round-Robin], [p=l-1=tt=SWS_EM_01043, p=l-1=Scheduling Other], [p=l-1=tt=SWS_EM_01053, p=l-1=Execution State Running], [p=l-1=tt=SWS_EM_01060, p=l-1=Shutdown state change behavior], [p=l-1=tt=SWS_EM_01065, p=l-1=Shutdown state timeout monitoring behavior], [p=l-1=tt=SWS_EM_01066, p=l-1=Start state change behavior], [p=l-1=tt=SWS_EM_01067, p=l-1=Confirm State Changes], [p=l-1=tt=SWS_EM_01069, p=l-1=Self-terminating Process State], [p=l-1=tt=SWS_EM_01070, p=l-1=Acknowledgement of termination request], [p=l-1=tt=SWS_EM_01071, p=l-1=Initiation of Process self-termination], [p=l-1=tt=SWS_EM_01072, p=l-1=Process Argument Zero], [p=l-1=tt=SWS_EM_01074, p=l-1=Short form arguments with option value], [p=l-1=tt=SWS_EM_01075, p=l-1=Short form Arguments without option value], [p=l-1=tt=SWS_EM_01076, p=l-1=Long form Arguments with option value], [p=l-1=tt=SWS_EM_01077, p=l-1=Long form Arguments without option value], [p=l-1=tt=SWS_EM_01107, p=l-1=Function Group configuration], [p=l-1=tt=SWS_EM_01109, p=l-1=Misconfigured Process instances], [p=l-1=tt=SWS_EM_01110, p=l-1=Off States], [p=l-1=tt=SWS_EM_02000, p=l-1=ExecutionState Enumeration], [p=l-1=tt=SWS_EM_02001], [p=l-1=tt=SWS_EM_02002, p=l-1=ExecutionClient::~ExecutionClient API], [p=l-1=tt=SWS_EM_02003, p=l-1=ExecutionClient::ReportExecutionState API], [p=l-1=tt=SWS_EM_02030, p=l-1=ExecutionClient::ExecutionClient API], [p=l-1=tt=SWS_EM_02044, p=l-1=State Change in Progress], [p=l-1=tt=SWS_EM_02049, p=l-1=State Change Failed], [p=l-1=tt=SWS_EM_02070, p=l-1=ExecutionReturnType Enumeration], [p=l-1=tt=SWS_EM_02109, p=l-1=Process pre-mapping], [p=l-1=tt=SWS_EM_02210], [p=l-1=tt=SWS_EM_NA]]}:
                    table caption Changed_Traceables_in_18_10  # Changed Traceables in 18-10
                chap_3a_Dltd_Trales_in_18_2d_10__553fb4d3  # Deleted Traceables in 18-10
                  table tgroup={thead=row=[p=l-1=e=Number, p=l-1=e=Heading], tbody=[[p=l-1=tt=SWS_EM_01044, p=l-1=Machine States Identification], [p=l-1=tt=SWS_EM_01108, p=l-1=Function Group State], [p=l-1=tt=SWS_EM_01111, p=l-1=No reference to Off State]]}:
                    table caption Deleted_Traceables_in_18_10  # Deleted Traceables in 18-10
                chap_3a_Added_Connts_in_18_2d_10__5aa73a6a: p=l-1=none  # Added Constraints in 18-10
                chap_3a_Chaged_Connts_in_18_2d_10__e015db2f: p=l-1=none  # Changed Constraints in 18-10
                chap_3a_Dltd_Connts_in_18_2d_10__1b77130d: p=l-1=none  # Deleted Constraints in 18-10
package /AUTOSAR/Documents/SWS_ExecutionManagement/LifeCycleInfoSets
  life cycle info set Requirements: default-lc-state=valid, used-life-cycle-state-definition-group=AutosarLifeCycleStates
    life-cycle-infos:
      lc-object=SWS_EM_NA, lc-state=draft
      lc-object=SWS_EM_01030, lc-state=draft
      lc-object=SWS_EM_01055, lc-state=draft
      lc-object=SWS_EM_01071, lc-state=draft
      lc-object=SWS_EM_02243, lc-state=draft
      lc-object=SWS_EM_02244, lc-state=draft
      lc-object=SWS_EM_01402, lc-state=draft
      lc-object=SWS_EM_01403, lc-state=draft
      lc-object=SWS_EM_01401, lc-state=draft
      lc-object=SWS_EM_{01002..01004}, lc-state=draft
      lc-object=SWS_EM_01404, lc-state=draft
      lc-object=SWS_EM_01405, lc-state=draft
      lc-object=SWS_EM_01006, lc-state=draft
      lc-object=SWS_EM_01050, lc-state=draft
      lc-object=SWS_EM_01051, lc-state=draft
      lc-object=SWS_EM_01012, lc-state=draft
      lc-object=SWS_EM_{01072..01077}, lc-state=draft
      lc-object=SWS_EM_02246, lc-state=draft
      lc-object=SWS_EM_02247, lc-state=draft
      lc-object=SWS_EM_02249, lc-state=draft
      lc-object=SWS_EM_02248, lc-state=draft
      lc-object=SWS_EM_01000, lc-state=draft
      lc-object=SWS_EM_01001, lc-state=draft
      lc-object=SWS_EM_01032, lc-state=draft
      lc-object=SWS_EM_02250, lc-state=draft
      lc-object=SWS_EM_01023, lc-state=draft
      lc-object=SWS_EM_02241, lc-state=draft
      lc-object=SWS_EM_02242, lc-state=draft
      lc-object=SWS_EM_01024, lc-state=draft
      lc-object=SWS_EM_01025, lc-state=draft
      lc-object=SWS_EM_01107, lc-state=draft
      lc-object=SWS_EM_01013, lc-state=draft
      lc-object=SWS_EM_01033, lc-state=draft
      lc-object=SWS_EM_01109, lc-state=draft
      lc-object=SWS_EM_02254, lc-state=draft
      lc-object=SWS_EM_01110, lc-state=draft
      lc-object=SWS_EM_01060, lc-state=draft
      lc-object=SWS_EM_02251, lc-state=draft
      lc-object=SWS_EM_01065, lc-state=draft
      lc-object=SWS_EM_02255, lc-state=draft
      lc-object=SWS_EM_02258, lc-state=draft
      lc-object=SWS_EM_01066, lc-state=draft
      lc-object=SWS_EM_02253, lc-state=draft
      lc-object=SWS_EM_02260, lc-state=draft
      lc-object=SWS_EM_02259, lc-state=draft
      lc-object=SWS_EM_02245, lc-state=draft
      lc-object=SWS_EM_01067, lc-state=draft
      lc-object=SWS_EM_02297, lc-state=draft
      lc-object=SWS_EM_02257, lc-state=draft
      lc-object=SWS_EM_02076, lc-state=draft
      lc-object=SWS_EM_02077, lc-state=draft
      lc-object=SWS_EM_01016, lc-state=draft
      lc-object=SWS_EM_{01062..01064}, lc-state=draft
      lc-object=SWS_EM_02261, lc-state=draft
      lc-object=SWS_EM_02262, lc-state=draft
      lc-object=SWS_EM_{01301..01304}, lc-state=draft
      lc-object=SWS_EM_{01351..01353}, lc-state=draft
      lc-object=SWS_EM_01305, lc-state=draft
      lc-object=SWS_EM_01306, lc-state=draft
      lc-object=SWS_EM_01308, lc-state=draft
      lc-object=SWS_EM_{01310..01313}, lc-state=draft
      lc-object=SWS_EM_{02102..02104}, lc-state=draft
      lc-object=SWS_EM_01014, lc-state=draft
      lc-object=SWS_EM_{01041..01043}, lc-state=draft
      lc-object=SWS_EM_01015, lc-state=draft
      lc-object=SWS_EM_{02106..02109}, lc-state=draft
      lc-object=SWS_EM_{02299..02309}, lc-state=draft
      lc-object=SWS_EM_02298, lc-state=draft
